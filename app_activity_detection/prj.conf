## CMakeLists.txt
```
cmake_minimum_required(VERSION 3.20.0)
list(APPEND ZEPHYR_EXTRA_MODULES
     ${CMAKE_CURRENT_SOURCE_DIR}/../../modules/lib/tflite-micro)
find_package(Zephyr REQUIRED HINTS $ENV{ZEPHYR_BASE})
project(app_activity_detection)

target_sources(app PRIVATE
    src/main.c
    src/boot.c
    src/ui.c
    src/home_screen.c
    src/touch.c
    src/storage.c
    src/acc_recorder.c
    model/activity_model.cpp 
    src/gravity_filter.c
    src/ml_engine.cpp 
    src/activity.c 
)
target_include_directories(app PRIVATE src model)
zephyr_library_include_directories(${CMAKE_CURRENT_SOURCE_DIR}/drivers)
# Driver headers (max32664c.h, max32664d.h, display_sh8601.h ...) may live in the
# base app's include dir; our own headers are app_*.h so nothing collides.
if(EXISTS ${CMAKE_CURRENT_LIST_DIR}/../app/include)
    target_include_directories(app PRIVATE ${CMAKE_CURRENT_LIST_DIR}/../app/include)
endif()
```

## Kconfig
```
# --- NCS v3.3 migration shim ---------------------------------------------
# With SB_CONFIG_SECURE_BOOT_NETCORE=y, NCS sysbuild (nrf/sysbuild/secureboot.cmake)
# pushes CONFIG_TFM_HAS_B0N into the default (app) image even on this secure
# `cpuapp` build that does not use TF-M. Upstream only defines TFM_HAS_B0N inside
# `if BUILD_WITH_TFM` (nrf/modules/trusted-firmware-m/Kconfig), and we blocklist
# trusted-firmware-m in west.yml, so the symbol is otherwise undefined here -- the
# sysbuild assignment then aborts Kconfig ("assign to undefined symbol"). Define an
# inert stub (mirrors the upstream prompt) purely to absorb that informative value.
# Nothing in this non-TF-M build reads it.
config TFM_HAS_B0N
	bool "Network core bootloader present (informative only, do not change)"
	depends on SOC_SERIES_NRF53
	help
	  Migration stub mirroring nrf/modules/trusted-firmware-m/Kconfig. Absorbs the
	  sysbuild-propagated CONFIG_TFM_HAS_B0N value on no-TF-M secure-boot builds.

source "Kconfig.zephyr"
```

## prj.conf
```kconfig
# Generated by setup_from_base.sh from ../app/prj.conf + app_overrides.conf
# HealthyPi Move specific configurations

CONFIG_BT=y
CONFIG_BT_PERIPHERAL=y
CONFIG_BT_BAS=y
CONFIG_BT_HRS=y
CONFIG_BT_DEVICE_NAME="healthypi move"
CONFIG_BT_DEVICE_APPEARANCE=833

CONFIG_BT_RX_STACK_SIZE=4096

CONFIG_BT_DIS=y
CONFIG_BT_DIS_PNP=n
CONFIG_BT_DIS_FW_REV=y
# NCS 3.2: BT_DIS_MANUF / BT_DIS_MODEL string options are deprecated.
# Use the *_NAME / *_NUMBER characteristics with their _STR values instead
# (BT_DIS_MANUF_NAME and BT_DIS_MODEL_NUMBER default to y).
CONFIG_BT_DIS_MANUF_NAME_STR="Protocentral"
CONFIG_BT_DIS_MODEL_NUMBER_STR="Move"
#CONFIG_BT_DIS_SETTINGS=y
#CONFIG_BT_DIS_STR_MAX=100

# Reduced Bluetooth data packets for flash optimization
CONFIG_BT_L2CAP_TX_MTU=247
CONFIG_BT_BUF_ACL_RX_SIZE=251
CONFIG_BT_BUF_ACL_TX_SIZE=251

# TX buffering for the streaming characteristics. ECG notifies ~16x/s while MCUmgr
# (DFU, FS reads) and the health-store sync share the same connection. On the
# stack defaults a burst on either side empties the pool, bt_gatt_notify() returns
# -ENOMEM and the ECG batch is simply gone — a contributor to the app's live ECG
# plot appearing only intermittently. (The primary fix for that report was in
# data_module.c: the ECG buffer was ALSO being notified on the BioZ characteristic,
# doubling this path's traffic with the wrong payload.)
#
# Sized against SRAM, not just latency: the L2CAP/ATT pools are the expensive pair
# at ~640 B per buffer. Measured on this tree — default -> 8/8 costs 3280 B and
# leaves 10.4 KB slack; 6/6 costs 1996 B and leaves ~11.7 KB. Given the v3.0.0
# field reports were LVGL allocation failures, doubling the default is the right
# trade. ACL TX is ~free here (52 B) but must stay BELOW CONFIG_BT_BUF_EVT_RX_COUNT
# (10): the controller may emit one Number-of-Completed-Packets event per
# outstanding ACL buffer, and bluetooth/buf.h BUILD_ASSERTs on it.
CONFIG_BT_BUF_ACL_TX_COUNT=8
CONFIG_BT_L2CAP_TX_BUF_COUNT=6
CONFIG_BT_ATT_TX_COUNT=6

# Preferred connection parameters (GAP PPCP). Units: intervals 1.25 ms,
# supervision timeout 10 ms.
#
# The supervision timeout was Zephyr's default of 42 = 420 ms, which is what a
# multi-minute OTA kept dying on: any RF gap longer than that — a hand over the
# watch, the phone pocketed, a microwave — tears the link down, and the watch
# logs "Disconnected ... reason 0x08" (BT_HCI_ERR_CONN_TIMEOUT) mid-upload. Four
# seconds rides out a transient without leaving a genuinely dead link hanging
# for long. Apple's Accessory Design Guidelines cap this at 6 s, so 400 is
# comfortably inside what iOS will grant; keep it there.
CONFIG_BT_PERIPHERAL_PREF_MIN_INT=24
CONFIG_BT_PERIPHERAL_PREF_MAX_INT=40
CONFIG_BT_PERIPHERAL_PREF_LATENCY=0
CONFIG_BT_PERIPHERAL_PREF_TIMEOUT=400
# BT_CTLR_DATA_LENGTH_MAX is a controller symbol: it belongs on the net core
# (set in app/sysbuild/ipc_radio/prj.conf), not the app/host core.

# Memory Configuration - Restored for debugging
CONFIG_HEAP_MEM_POOL_SIZE=24576        
CONFIG_SYSTEM_WORKQUEUE_STACK_SIZE=24576 
CONFIG_MAIN_STACK_SIZE=16384           

# CONFIG_PM_OVERRIDE_EXTERNAL_DRIVER_CHECK=y

# Zephyr OS Configuration - Debug enabled
CONFIG_SMF=y
CONFIG_EVENTS=y
CONFIG_CBPRINTF_FP_SUPPORT=y

# NCS v3.3 made the build-time init-priority check reject a non-deferred device
# depending on a deferred one. Our lvgl pointer-input (/pointer) depends on the
# chsc5816 touch, which is deferred-init and brought up by the display SMF after
# the panel reset sequence (smf_display.c). The sanctioned fix -- also deferring
# the pointer -- is blocked because the upstream zephyr,lvgl-pointer-input binding
# does not declare zephyr,deferred-init, and un-deferring touch would init it
# before the display is ready. The arrangement is runtime-safe (the pointer init
# only registers an input callback; it never touches the deferred device), so the
# check is disabled here. TODO: revisit with on-device validation (defer the
# pointer once the binding allows it, or restructure touch/pointer init).
CONFIG_CHECK_INIT_PRIORITIES=n

# Enable debugging features for development
CONFIG_ASSERT=y
# CONFIG_DEBUG_INFO removed: undefined symbol on NCS 3.2 (thread debug info below
# is what we actually rely on).
CONFIG_DEBUG_THREAD_INFO=y
CONFIG_THREAD_NAME=y
CONFIG_THREAD_STACK_INFO=y

# Size optimization disabled for debugging
#CONFIG_SIZE_OPTIMIZATIONS=y
#CONFIG_COMPILER_OPT="-Os"

# Peripheral device drivers
CONFIG_SENSOR=y
CONFIG_SENSOR_INFO=y
CONFIG_SENSOR_MAX30001=y
CONFIG_SENSOR_MAX32664D=y
CONFIG_SENSOR_MAX30208=y
# AS6221 temperature sensor (newer HW revisions) via the upstream TMP108 driver,
# which supports the ams,as6221 variant. Detected at runtime in hw_module.c.
CONFIG_TMP108=y
#CONFIG_SENSOR_MAXM86146=y
CONFIG_SENSOR_MAX32664C_PC=y
CONFIG_SENSOR_ASYNC_API=y
# P3: MAX30001 DRDY (INTB/P1.09) interrupt-driven acquisition (ECG/BioZ FIFO reads
# driven by the interrupt instead of poll timers). If the DRDY handler fails to
# arm at boot, acquisition transparently falls back to the poll timers. Under
# on-device validation - watch the boot log for "INTB interrupt-driven".
CONFIG_MAX30001_TRIGGER=y

CONFIG_REGULATOR=y
CONFIG_ADC=n

CONFIG_SENSOR_BMI323_HPI=y
# P3: BMI323 any-motion (wake-on-motion) interrupt on INT1 (P1.12). Arms at boot;
# handler logs "any-motion detected" + counts events (foundation for P4 wear-state
# gating). Under on-device validation - uses the sensor's POR motion thresholds.
CONFIG_RTC=y
CONFIG_RTC_RV8263=y

CONFIG_INPUT=y
CONFIG_INPUT_CHSC5816=y
CONFIG_INPUT_CST816S=y

CONFIG_I2C=y
CONFIG_I2C_NRFX=y
# DEBUG (QFN MAX32664C bring-up): a MAX32664 firmware page is one 8210-byte
# write, ~0.75 s at 100 kHz; the 500 ms default times it out.
CONFIG_I2C_NRFX_TRANSFER_TIMEOUT=2000
CONFIG_FUEL_GAUGE=y
CONFIG_NRF_FUEL_GAUGE=y
CONFIG_NRF_FUEL_GAUGE_VARIANT_SECONDARY_CELL=y

CONFIG_DISPLAY=y
CONFIG_SH8601=y

CONFIG_INPUT_GPIO_KEYS=y

CONFIG_LED=n
CONFIG_REBOOT=y
CONFIG_PWM=n

# Filesystem & Internal Flash support to store data
CONFIG_FLASH=y
CONFIG_FLASH_MAP=y
CONFIG_FLASH_PAGE_LAYOUT=y
CONFIG_FILE_SYSTEM=y
CONFIG_FILE_SYSTEM_LITTLEFS=y
CONFIG_MPU_ALLOW_FLASH_WRITE=y
# Concurrent open files: sample-store flush (1) + health-store record-tier active
# capture sessions (HS_REC_MAX_ACTIVE=2) + a transient RECORDS reader + settings +
# MAX32664 MSBL flashing. Default (4) is too few; give headroom.
CONFIG_FS_LITTLEFS_NUM_FILES=8

# Enabled settings module and FS to store settings
CONFIG_SETTINGS=y
CONFIG_SETTINGS_RUNTIME=y
CONFIG_SETTINGS_FILE=y
CONFIG_SETTINGS_FILE_PATH="/lfs/sys/settings"

CONFIG_NVS=y

# LVGL Library Options - Debug configuration
CONFIG_LVGL=y
CONFIG_LV_COLOR_DEPTH_16=y
CONFIG_LV_COLOR_16_SWAP=y
# Display flush buffer bits-per-pixel. Must match the render depth (RGB565 =
# 16bpp) and the RGB565 panel; it was defaulting to 32, allocating the LVGL
# draw buffer (buf0) at 4 bytes/px instead of 2 -> ~30 KB wasted SRAM plus a
# 32->16 conversion per flush. P5: reclaim it for the screen cache.
CONFIG_LV_Z_BITS_PER_PIXEL=16
# The SH8601 family needs even-aligned CASET/PASET windows. With 1-px alignment
# LVGL flushes 39-row strips (VDB_SIZE=10 on 390x390), so every other strip
# starts on an odd row; the V2 display module then leaves one GRAM row
# unwritten per strip boundary (periodic green lines). Round flush areas to
# 2 px on both axes; LVGL also rounds the strip height to match.
CONFIG_LV_Z_AREA_X_ALIGNMENT_WIDTH=2
CONFIG_LV_Z_AREA_Y_ALIGNMENT_WIDTH=2
CONFIG_LV_THEME_DEFAULT_DARK=y
CONFIG_LV_Z_MEM_POOL_SYS_HEAP=y
# LVGL object pool. Grown after placeholder fill-in (sparks/bars/ages) so the
# active tile + neighbors + one special screen fit without glyph draw OOM
# (lv_draw_label ASSERT_MALLOC). Carousel tiles are lazy-built to stay inside
# this budget; still allow a few resident heavy monitors.
#
# Raised 60K -> 80K for v3.0.0: three field reports of the watch restarting on a
# swipe (SpO2 plot, Settings, the pull-down shade) were LVGL allocation failures.
# The structural fix is hpi_scr_release_current() (the outgoing screen is now
# freed BEFORE the incoming one is built) plus carousel tile eviction; this is
# the fragmentation headroom on top of it. ~35 KB of SRAM was unallocated —
# check the build's RAM report still shows >=10 KB slack after any further bump.
# Note the LVGL draw buffers are static and do NOT come out of this pool.
CONFIG_LV_Z_MEM_POOL_SIZE=81920
#CONFIG_LV_MEM_CUSTOM=y
CONFIG_LV_Z_POINTER_INPUT_MSGQ_COUNT=50
CONFIG_LV_Z_POINTER_INPUT=y
#CONFIG_LV_DISP_DEF_REFR_PERIOD=30

# LVGL Font Options - Reduced font set to save flash
#CONFIG_LV_FONT_MONTSERRAT_12=y
#CONFIG_LV_FONT_MONTSERRAT_14=y
#CONFIG_LV_FONT_MONTSERRAT_16=y
CONFIG_LV_FONT_MONTSERRAT_20=y
CONFIG_LV_FONT_MONTSERRAT_24=y
# Enable the large splash-screen title font.
CONFIG_LV_FONT_MONTSERRAT_48=y
CONFIG_LV_FONT_MONTSERRAT_28=y
#CONFIG_LV_FONT_MONTSERRAT_34=y
#CONFIG_LV_FONT_MONTSERRAT_42=y
#CONFIG_LV_FONT_MONTSERRAT_12_SUBPX=y
CONFIG_LV_FONT_DEFAULT_MONTSERRAT_24=y
#CONFIG_LV_USE_FONT_SUBPX=y

CONFIG_LV_USE_LABEL=y
CONFIG_LV_USE_MSGBOX=y
CONFIG_LV_USE_CHART=y
CONFIG_LV_USE_ROLLER=y  
CONFIG_LV_USE_BUTTONMATRIX=y
CONFIG_LV_USE_SPINNER=y

CONFIG_LV_USE_CALENDAR=n
CONFIG_LV_USE_CHECKBOX=n
CONFIG_LV_USE_DROPDOWN=n
CONFIG_LV_USE_IMAGEBUTTON=n
CONFIG_LV_USE_KEYBOARD=n
CONFIG_LV_USE_LIST=n
CONFIG_LV_USE_MENU=n
CONFIG_LV_USE_LOTTIE=n
CONFIG_LV_USE_CANVAS=n
CONFIG_LV_USE_ANIMIMG=n
CONFIG_LV_USE_LED=n
CONFIG_LV_USE_LINE=n
CONFIG_LV_USE_SCALE=n
CONFIG_LV_USE_SPINBOX=n
CONFIG_LV_USE_TABLE=n
CONFIG_LV_USE_TABVIEW=n
CONFIG_LV_USE_TILEVIEW=y
CONFIG_LV_USE_WIN=n

# USB Configuration
#
# The legacy USB device stack (CONFIG_USB_DEVICE_STACK) is deprecated on NCS 3.2.
# USB CDC streaming is currently dormant (usb_enable() was already #if 0'd), so it
# is disabled here for a clean v3.2 build. The CDC code in hw_module.c /
# data_module.c is guarded by CONFIG_USB_DEVICE_STACK and compiles out while off.
#
# USB CAN BE RE-ENABLED LATER for continuous-streaming applications: migrate to
# the new USB device stack (CONFIG_USB_DEVICE_STACK_NEXT / USBD), restore the
# settings below, and re-enable USB init in hw_module.c (usb_init/CDC ISR).
#   CONFIG_USB_DEVICE_STACK=y
#   CONFIG_USB_DEVICE_PRODUCT="healthypi move"
#   CONFIG_USB_DEVICE_PID=0x0001
#   CONFIG_USB_DEVICE_VID=0x4440
#   CONFIG_USB_DEVICE_INITIALIZE_AT_BOOT=n

# Enable the serial MCUmgr transport.
CONFIG_BASE64=y
#CONFIG_MCUMGR_TRANSPORT_UART=y
# Partition Manager placement for the LittleFS volume (restored with PM). The
# static map in app/pm_static.yml fixes the actual address/size; these tell PM
# which region the partition belongs to.
CONFIG_PM_PARTITION_REGION_LITTLEFS_EXTERNAL=y
CONFIG_PM_PARTITION_SIZE_LITTLEFS=0x200000

CONFIG_NORDIC_QSPI_NOR=y
CONFIG_NORDIC_QSPI_NOR_FLASH_LAYOUT_PAGE_SIZE=4096
CONFIG_NORDIC_QSPI_NOR_STACK_WRITE_BUFFER_SIZE=16

# M3 (PM->DTS): partition location/size (littlefs on external flash, MCUboot
# secondary on external flash) is now expressed in the board devicetree, not
# via these Partition Manager options. (CONFIG_PM_DEVICE below is power
# management, unrelated to Partition Manager.)

CONFIG_REQUIRES_FULL_LIBC=y
CONFIG_CMSIS_DSP=y
CONFIG_CMSIS_DSP_FILTERING=y

# CONFIG_PM (system power-management policy) depends on HAS_PM, which the nRF5340
# does not select. It was silently dropped before and is a fatal warning on NCS
# 3.2. nRF53 low-power is via device PM + idle, addressed properly in plan P4.
# CONFIG_PM=y
CONFIG_PM_DEVICE=y
# CONFIG_PM_DEVICE_RUNTIME was tried for external-flash Deep-Power-Down but
# REVERTED: it is a global toggle, and with it on the deferred-init touch
# controller (chsc5816) comes up SUSPENDED after device_init() (nothing calls
# pm_device_runtime_get), so touch stops scanning and the display never wakes —
# device stuck on the home screen. Flash DPD must be redone at the measurement
# session with the touch/display resume path handled explicitly (pm_device
# _runtime_get on the touch/display devices, or exclude them). Keep OFF.
#CONFIG_PM_DEVICE_RUNTIME=y

# Enable the poweroff command (for power profiling)
CONFIG_POWEROFF=y

# P0 safety net: hardware-backed task watchdog for thread-stall detection
CONFIG_WATCHDOG=y
CONFIG_TASK_WDT=y
# One channel per watched thread. P2 registers 6 (smf_display, smf_ppg_wrist,
# ppg_wrist_ctrl, smf_ecg, smf_ppg_finger, ppg_fi_ctrl); the default of 5 is too
# few (task_wdt_add -> -ENOMEM). Headroom for data_thread/hw_thread added later.
CONFIG_TASK_WDT_CHANNELS=10

CONFIG_ZBUS=y

# Bootloader Configuration
CONFIG_BOOTLOADER_MCUBOOT=y
#CONFIG_SECURE_BOOT=y

# Enable MCUmgr and dependencies.

CONFIG_FLASH=y

CONFIG_MCUMGR=y
CONFIG_IMG_MANAGER=y
CONFIG_MCUMGR_GRP_IMG=y
CONFIG_MCUMGR_GRP_OS=y
# CONFIG_MCUMGR_GRP_FS removed 2026-07-18 (H5 cutover): the old whole-file record
# pull is fully replaced by the HPI_HS RECORDS command and the app has migrated.
# Dropping the generic FS group also closes the read/write-any-file-over-BLE surface.

# Per-unit device id (SoC FICR) exposed as HPI_HS HELLO.uid, so a client can key
# its sample store per watch instead of on the fixed `dev` model string.
CONFIG_HWINFO=y

# HS-2 P1 validation (plan 2.4): log within-epoch spread as each epoch closes, so
# the 1-min HR / 5-min temp epoch lengths can be checked against REAL WEAR rather
# than assumed. Re-enable for an epoch-length validation wear session, then turn back
# off -- it is pure log noise otherwise.
# CONFIG_HPI_HS_EPOCH_SPREAD_LOG=y

# HS-2 Tier 2: synthetic data generator. Lets us test trends / baselines / retention /
# sync-at-scale without wearing the watch for a week. Triggered ON DEMAND by the
# HPI_HS `SYNTH` MCUmgr command (id 6) over BLE -- never at boot. Every sample is
# branded HPI_HS_Q_SYNTHETIC.
#
# OFF DELIBERATELY -- DO NOT ENABLE IN ANYTHING THAT SHIPS. This fabricates
# physiologically plausible HR/temp/steps into the SAME store as real measurements.
# The only thing telling them apart is the HPI_HS_Q_SYNTHETIC quality bit, i.e. a
# client that forgets to filter renders invented vitals as if they were measured.
# Re-enable only for local testing, and remember the watch's store keeps whatever
# was already generated -- turning this off does not erase it.
# CONFIG_HPI_HS_SYNTH=y

CONFIG_NET_BUF=y
CONFIG_ZCBOR=y
CONFIG_CRC=y
CONFIG_MCUMGR=y
CONFIG_STREAM_FLASH=y
CONFIG_FLASH_MAP=y

CONFIG_MCUMGR_TRANSPORT_BT_REASSEMBLY=y
CONFIG_MCUMGR_TRANSPORT_NETBUF_SIZE=1024
CONFIG_MCUMGR_GRP_OS_MCUMGR_PARAMS=y
# Increased from 2048 to 4096 to prevent stack overflow during file downloads via SMP
# File system operations + CBOR encoding + network buffers require more stack space
CONFIG_MCUMGR_TRANSPORT_WORKQUEUE_STACK_SIZE=4096

CONFIG_MCUMGR_MGMT_NOTIFICATION_HOOKS=y
CONFIG_MCUMGR_GRP_IMG_UPLOAD_CHECK_HOOK=y
CONFIG_MCUMGR_GRP_IMG_STATUS_HOOKS=y

CONFIG_NCS_SAMPLE_MCUMGR_BT_OTA_DFU=y
CONFIG_NCS_SAMPLE_MCUMGR_BT_OTA_DFU_SPEEDUP=y

# --- Net-core (image 1) DFU, explicit ---
# These are auto-derived today from SB_CONFIG_NETCORE_APP_UPDATE (2-image build),
# but net-core OTA is bootloader-critical, so pin the load-bearing symbols here so
# a future default/Kconfig shift can't silently disable them (and shows a build
# warning if their deps ever stop being met).
# The nRF5340 net-core image-1 *primary* slot (slot2, flash area ID 3) is a
# deliberately-disabled RAM sim partition; MCUMGR_GRP_IMG_NRF5340_BOOTUTIL_HOOK
# makes the img-mgmt swap-state read for that slot return "unpopulated" instead of
# opening area 3 (which -ENOENTs by design) — WITHOUT it, an image-1 upload hits
# BOOT_SWAP_TYPE_PANIC and the client gets SMP rc=1. The upload lands in
# slot3_partition (QSPI) and MCUboot PCD-copies it to the net core on reboot.
CONFIG_MCUMGR_GRP_IMG_UPDATABLE_IMAGE_NUMBER=2
CONFIG_MCUMGR_GRP_IMG_NRF5340_BOOTUTIL_HOOK=y


CONFIG_NCS_APPLICATION_BOOT_BANNER_STRING="HealthyPi Move"

# Debug logging options - Re-enabled for debugging
CONFIG_SERIAL=y
CONFIG_LOG=y
CONFIG_CONSOLE=y 
CONFIG_UART_CONSOLE=y

CONFIG_USE_SEGGER_RTT=n
CONFIG_SHELL_BACKEND_RTT=n 
CONFIG_LOG_BACKEND_RTT=n

# Enable individual sensor logging for debugging
CONFIG_SENSOR_LOG_LEVEL_INF=y
CONFIG_LV_USE_LOG=n
# LV_LOG_LEVEL_* only applies when LV_USE_LOG=y; setting a level with LVGL logging
# off is a fatal Kconfig warning on NCS 3.2.
CONFIG_DISPLAY_LOG_LEVEL_ERR=y
CONFIG_INPUT_LOG_LEVEL_ERR=y

#Setup individual log levels for each sensor - enabled for debugging
CONFIG_MAX32664C_LOG_LEVEL_INF=y
CONFIG_MAX32664D_LOG_LEVEL_INF=y
CONFIG_BMI323_HPI_LOG_LEVEL_INF=y
CONFIG_MAX30001_LOG_LEVEL_INF=y

# Init changes for QSPI XIP code placement
#CONFIG_CUSTOM_LINKER_SCRIPT="linker_arm_extxip.ld"
#CONFIG_FLASH_INIT_PRIORITY=40
#CONFIG_SHELL_BACKEND_SERIAL_INIT_PRIORITY=50
#CONFIG_CODE_DATA_RELOCATION=y
#CONFIG_NORDIC_QSPI_NOR_XIP=y

# Configure Bluetooth Security Manager
CONFIG_BT_SMP=y
# CONFIG_BT_SIGNING (LE data signing) is deprecated on NCS 3.2 and unused here
# (the command/data services use plain writes + notifications).
CONFIG_BT_BONDABLE=y

CONFIG_BT_KEYS_OVERWRITE_OLDEST=y
CONFIG_BT_MAX_PAIRED=2
CONFIG_BT_SETTINGS=y


CONFIG_LOG=y
CONFIG_LOG_MODE_DEFERRED=y
CONFIG_CBPRINTF_FP_SUPPORT=y
CONFIG_NEWLIB_LIBC=y
CONFIG_NEWLIB_LIBC_FLOAT_PRINTF=y

CONFIG_CBPRINTF_COMPLETE=y


# Enable full libc with float printf support
CONFIG_CBPRINTF_FP_SUPPORT=y
CONFIG_CBPRINTF_COMPLETE=y  

# CONFIG_MINIMAL_LIBC=y
CONFIG_CMSIS_DSP=y
CONFIG_CMSIS_DSP_TRANSFORM=y
CONFIG_CMSIS_DSP_SUPPORT=y
CONFIG_CMSIS_DSP_FASTMATH=y

# Greenfield time-sync: phone sets the RTC via the standard MCUmgr os datetime
# command (uses the board rtc alias = rtc_rv / RV8263), replacing the removed
# custom SET_DEVICE_TIME command. HOOK lets the app re-sync the software
# RTC↔uptime offset after a set so UI + health-store timestamps update live.
CONFIG_MCUMGR_GRP_OS_DATETIME=y
CONFIG_MCUMGR_GRP_OS_DATETIME_HOOK=y

CONFIG_INPUT=y
CONFIG_CPP=y
CONFIG_STD_CPP17=y
CONFIG_TENSORFLOW_LITE_MICRO=y
CONFIG_REQUIRES_FLOAT_PRINTF=y
CONFIG_BMI323=y
CONFIG_FPU=y
CONFIG_CMSIS_NN=y
CONFIG_TENSORFLOW_LITE_MICRO_CMSIS_NN_KERNELS=y
```

## src/main.c
```c
#include <zephyr/kernel.h>
#include <zephyr/logging/log.h>
#include "boot.h"

LOG_MODULE_REGISTER(main, LOG_LEVEL_INF);

int main(void)
{
	bool ok = boot_run();

	LOG_INF("Boot finished: recording %s", ok ? "available" : "NOT available");

	/* Everything else runs in threads: the UI thread (app_ui) switches to the
	 * home screen by itself, the recorder thread (acc_recorder) waits for the
	 * Start button. */
	return 0;
}
```

## src/acc_recorder.c
```c
/*
 * BMI323 accelerometer logger -> CSV on LittleFS.
 *
 * File:   /lfs/acc/acc_NNNN.csv   (NNNN increments across power cycles)
 * Format: t_ms,ax_mg,ay_mg,az_mg  (milli-g, t_ms since the start of the session)
 *
 * The UI only calls acc_rec_request_start()/stop() and polls the getters; all
 * sensor and filesystem work happens on the recorder thread.
 */
#include <zephyr/kernel.h>
#include <zephyr/device.h>
#include <zephyr/drivers/sensor.h>
#include <zephyr/drivers/rtc.h>
#include <zephyr/fs/fs.h>
#include <zephyr/logging/log.h>
#include <stdio.h>
#include <stdlib.h>
#include <string.h>
#include <zephyr/sys/printk.h>
#include <time.h>
#include <zephyr/sys/timeutil.h>
#include "acc_recorder.h"
#include "storage.h"
#include "boot.h"
#include "activity.h"

LOG_MODULE_REGISTER(acc_rec, LOG_LEVEL_INF);

#define ACC_ODR_HZ        50
#define ACC_RANGE_G       8
#define ACC_PERIOD_MS     (1000 / ACC_ODR_HZ)

#define WBUF_SIZE         2048
#define FLUSH_AT          1024            /* bytes buffered before a write */
#define SYNC_INTERVAL_MS  5000            /* fs_sync + free-space check */
#define MIN_FREE_BYTES    (64 * 1024)     /* stop before the volume fills up */
#define MAX_READ_ERRORS   50              /* consecutive sensor errors -> abort */

#define REC_STACK_SIZE    6144
#define REC_PRIORITY      6

#define MAX_STALLS  15              /* 15 x 200 ms = 3 s without data */

static atomic_t g_state = ATOMIC_INIT(ACC_REC_IDLE);
static atomic_t g_start_req = ATOMIC_INIT(0);
static atomic_t g_stop_req = ATOMIC_INIT(0);
static volatile uint32_t g_samples;
static volatile uint32_t g_elapsed_s;
static char g_path[48];
static const char *g_err = "";

K_SEM_DEFINE(sem_rec_cmd, 0, 1);

K_MSGQ_DEFINE(acc_rec_q, sizeof(struct acc_sample), 64, 4);

static struct fs_file_t g_file;
static char wbuf[WBUF_SIZE];
static size_t wlen;


void acc_rec_request_start(void)
{
	enum acc_rec_state s = atomic_get(&g_state);

	if (s == ACC_REC_IDLE || s == ACC_REC_ERROR) {
		atomic_set(&g_start_req, 1);
		k_sem_give(&sem_rec_cmd);
	}
}

void acc_rec_request_stop(void)
{
	if (atomic_get(&g_state) == ACC_REC_RECORDING) {
		atomic_set(&g_stop_req, 1);
	}
}

enum acc_rec_state acc_rec_get_state(void) { return (enum acc_rec_state)atomic_get(&g_state); }
uint32_t acc_rec_get_samples(void) { return g_samples; }
uint32_t acc_rec_get_elapsed_s(void) { return g_elapsed_s; }
const char *acc_rec_get_error(void) { return g_err; }

const char *acc_rec_get_filename(void)
{
	const char *slash = strrchr(g_path, '/');

	return slash ? slash + 1 : g_path;
}


static int flush_buf(void)
{
	if (wlen == 0) {
		return 0;
	}
	ssize_t w = fs_write(&g_file, wbuf, wlen);

	if (w < 0) {
		return (int)w;
	}
	if ((size_t)w != wlen) {
		return -EIO;
	}
	wlen = 0;
	return 0;
}

static int buf_append(const char *s, size_t n)
{
	if (wlen + n > sizeof(wbuf)) {
		int rc = flush_buf();

		if (rc < 0) {
			return rc;
		}
	}
	memcpy(wbuf + wlen, s, n);
	wlen += n;
	return 0;
}

/* Next free acc_NNNN.csv index */
static int next_index(uint32_t *out)
{
	struct fs_dir_t dir;
	struct fs_dirent ent;
	uint32_t max = 0;

	fs_dir_t_init(&dir);
	int rc = fs_opendir(&dir, STORAGE_ACC_DIR);

	if (rc < 0) {
		return rc;
	}
	while (fs_readdir(&dir, &ent) == 0 && ent.name[0] != '\0') {
		if (ent.type == FS_DIR_ENTRY_FILE && strncmp(ent.name, "acc_", 4) == 0) {
			char *end;
			unsigned long n = strtoul(ent.name + 4, &end, 10);

			if (end != ent.name + 4 && strcmp(end, ".csv") == 0 && n > max) {
				max = (uint32_t)n;
			}
		}
	}
	fs_closedir(&dir);
	*out = max + 1;
	return 0;
}

static void fail(const char *why)
{
	LOG_ERR("Recording failed: %s", why);
	g_err = why;
	atomic_set(&g_state, ACC_REC_ERROR);
}

void acc_rec_dump_file(const char *path)
{
	struct fs_file_t f;
	char buf[128];
	ssize_t n;

	fs_file_t_init(&f);
	if (fs_open(&f, path, FS_O_READ) < 0) {
		printk("dump: cannot open %s\n", path);
		return;
	}
	printk("\n=====BEGIN %s=====\n", path);
	while ((n = fs_read(&f, buf, sizeof(buf) - 1)) > 0) {
		buf[n] = '\0';
		printk("%s", buf);
		k_msleep(10);              
	}
	printk("\n=====END=====\n");
	fs_close(&f);
}

static void record_session(void)
{
	char line[128];
	uint32_t idx;
	int rc;
	const char *end_err = NULL;

	atomic_set(&g_state, ACC_REC_OPENING);
	atomic_set(&g_stop_req, 0);
	g_samples = 0;
	g_elapsed_s = 0;
	g_err = "";
	wlen = 0;

	if (storage_free_bytes() < MIN_FREE_BYTES) {
		fail("Storage full");
		return;
	}
	if (next_index(&idx) < 0) {
		fail("Cannot list /lfs/acc");
		return;
	}

	snprintf(g_path, sizeof(g_path), STORAGE_ACC_DIR "/acc_%04u.csv", (unsigned int)idx);
	fs_file_t_init(&g_file);
	rc = fs_open(&g_file, g_path, FS_O_CREATE | FS_O_WRITE);
	if (rc < 0) {
		LOG_ERR("fs_open(%s) = %d", g_path, rc);
		fail("Cannot create file");
		return;
	}

	/* Header: rate/units and column names */
	{
		int n = snprintf(line, sizeof(line), "# rate_hz=%d unit=m/s2\n", ACC_SAMPLE_HZ);

		buf_append(line, n);
		buf_append("timestamp,ax,ay,az,class,conf_pct,infer_ms\n",
			   sizeof("timestamp,ax,ay,az,class,conf_pct,infer_ms\n") - 1);
	}

	k_msgq_purge(&acc_rec_q);          /* drop stale samples from before Start */

	LOG_INF("Recording to %s @ %d Hz", g_path, ACC_SAMPLE_HZ);
	atomic_set(&g_state, ACC_REC_RECORDING);

	int64_t t0 = k_uptime_get();
	int64_t last_sync = t0;
	int stalls = 0;
	bool first = true;

	/* Wall-clock time at Start, as epoch seconds (0 if the RTC is invalid) */
	int64_t base_epoch = 0;
	{
		struct rtc_time rt;

		if (g_boot.rtc_ok && rtc_get_time(g_rtc_dev, &rt) == 0) {
			struct tm tmv = {
				.tm_sec = rt.tm_sec,
				.tm_min = rt.tm_min,
				.tm_hour = rt.tm_hour,
				.tm_mday = rt.tm_mday,
				.tm_mon = rt.tm_mon,
				.tm_year = rt.tm_year,
			};

			base_epoch = timeutil_timegm64(&tmv);
		}
	}

	while (!atomic_get(&g_stop_req)) {
		struct acc_sample s;

		if (k_msgq_get(&acc_rec_q, &s, K_MSEC(200)) != 0) {
			if (++stalls >= MAX_STALLS) {
				end_err = "IMU stalled";
				break;
			}
		} else {
			stalls = 0;

			uint32_t t_ms = s.t_ms - (uint32_t)t0;
			struct activity_result r;
			struct tm tmv;
			time_t ts = (time_t)(base_epoch + t_ms / 1000);
			int n;

			activity_get_result(&r);
			gmtime_r(&ts, &tmv);

			/* every row carries the latest class name, confidence and inference time */
			n = snprintf(line, sizeof(line),
            "%04d-%02d-%02d %02d:%02d:%02d.%03u,%.3f,%.3f,%.3f,%s,%u,%u\n",
            tmv.tm_year + 1900, tmv.tm_mon + 1, tmv.tm_mday,
            tmv.tm_hour, tmv.tm_min, tmv.tm_sec,
            (unsigned int)(t_ms % 1000),
            (double)s.x, (double)s.y, (double)s.z,
            r.label ? r.label : "none",
            (unsigned int)r.conf_pct,
            (unsigned int)r.infer_ms);

			if (n > 0 && n < (int)sizeof(line)) {
				if (buf_append(line, n) < 0) {
					end_err = "Write error";
					break;
				}
				g_samples++;
			}
			if (first) {
				first = false;
				/* sanity check: |a| should be ~9.8 m/s2 at rest */
				LOG_INF("First sample: %.2f, %.2f, %.2f m/s2",
					(double)s.x, (double)s.y, (double)s.z);
			}
		}

		if (wlen >= FLUSH_AT && flush_buf() < 0) {
			end_err = "Write error";
			break;
		}

		int64_t now = k_uptime_get();

		g_elapsed_s = (uint32_t)((now - t0) / 1000);

		if (now - last_sync >= SYNC_INTERVAL_MS) {
			last_sync = now;
			if (flush_buf() < 0 || fs_sync(&g_file) < 0) {
				end_err = "Write error";
				break;
			}
			if (storage_free_bytes() < MIN_FREE_BYTES) {
				end_err = "Storage full - stopped";
				break;
			}
		}
	}

	atomic_set(&g_state, ACC_REC_CLOSING);

	rc = flush_buf();
	if (rc < 0 && end_err == NULL) {
		end_err = "Write error";
	}
	fs_sync(&g_file);
	fs_close(&g_file);

	LOG_INF("Recording stopped: %s, %u samples, %u s", g_path, (unsigned int)g_samples,
		(unsigned int)g_elapsed_s);
     acc_rec_dump_file(g_path);

	if (end_err) {
		fail(end_err);
	} else {
		atomic_set(&g_state, ACC_REC_IDLE);
	}
}
static void rec_thread(void *a, void *b, void *c)
{
	ARG_UNUSED(a);
	ARG_UNUSED(b);
	ARG_UNUSED(c);

	for (;;) {
		k_sem_take(&sem_rec_cmd, K_FOREVER);
		if (atomic_cas(&g_start_req, 1, 0)) {
			record_session();
		}
	}
}

K_THREAD_DEFINE(rec_thread_id, REC_STACK_SIZE, rec_thread, NULL, NULL, NULL, REC_PRIORITY, 0, 0);
```

## src/acc_recorder.h
```c
#ifndef ACC_RECORDER_H
#define ACC_RECORDER_H

#include <stdint.h>
#include <zephyr/kernel.h>

enum acc_rec_state {
	ACC_REC_IDLE = 0,
	ACC_REC_OPENING,   /* configuring IMU + creating the file */
	ACC_REC_RECORDING,
	ACC_REC_CLOSING,   /* flushing + closing the file */
	ACC_REC_ERROR,     /* last session failed; see acc_rec_get_error() */
};

#define ACC_SAMPLE_HZ 20  

struct acc_sample {
	uint32_t t_ms;
	float x, y, z;                  /* m/s^2, gravity included */
};


extern struct k_msgq acc_rec_q; 

/* Non-blocking requests; the recorder thread does the work. */
void acc_rec_request_start(void);
void acc_rec_request_stop(void);

enum acc_rec_state acc_rec_get_state(void);
uint32_t acc_rec_get_samples(void);
uint32_t acc_rec_get_elapsed_s(void);
const char *acc_rec_get_filename(void); /* current / last file, no directory ("" if none) */
const char *acc_rec_get_error(void);
void acc_rec_dump_file(const char *path);
#endif
```

## src/activity.c
```c
#include <zephyr/kernel.h>
#include <zephyr/device.h>
#include <zephyr/devicetree.h>
#include <zephyr/drivers/sensor.h>
#include <zephyr/logging/log.h>
#include <string.h>
#include <math.h>

#include "gravity_filter.h"
#include "ml_engine.h"
#include "activity_model.h"    
#include "acc_recorder.h"
#include "activity.h"

LOG_MODULE_REGISTER(activity, LOG_LEVEL_INF);

#define MODEL_DATA  activity_model
#define MODEL_LEN   ACTIVITY_MODEL_LEN

#define TFLITE_TYPE_INT8    9   /* kTfLiteInt8 */

#define IN_COUNT (ACTIVITY_WINDOW_LEN * 3)

#define ACTIVITY_WINDOW_LEN  24     /* st_gmp_wl_24 */
#define ACTIVITY_NUM_AXES    3
#define ACTIVITY_NUM_CLASSES 4

#define SAMPLE_PERIOD_MS 50     /* 20 Hz (WISDM).  */
#define IN_COUNT (ACTIVITY_WINDOW_LEN * 3)

#define ACT_STACK_SIZE    8192
#define ACT_PRIORITY      6

static atomic_t res_idx  = ATOMIC_INIT(ACT_RES_NONE);
static atomic_t res_conf = ATOMIC_INIT(0);
static atomic_t res_ms   = ATOMIC_INIT(0);
static atomic_t res_seq = ATOMIC_INIT(0);

/* set once in activity_model_init() from the tensor info */
static float   in_inv_scale;
static int32_t in_zp;
static float   out_scale;
static int32_t out_zp;


static const char *const labels[ACTIVITY_NUM_CLASSES] = {
	"jogging", "stationary", "stairs", "walking"
};

static const struct device *accel = DEVICE_DT_GET_OR_NULL(DT_NODELABEL(bmi323));

static struct ml_tensor_info in_info, out_info;

void activity_get_result(struct activity_result *r)
{
	int idx = (int)atomic_get(&res_idx);

	r->idx = idx;
	r->label = (idx >= 0 && idx < ACTIVITY_NUM_CLASSES) ? labels[idx] : NULL;
	r->conf_pct = (uint8_t)atomic_get(&res_conf);
	r->infer_ms = (uint32_t)atomic_get(&res_ms);
    r->seq = (uint32_t)atomic_get(&res_seq);
}

int activity_model_init(void)
{
	int ret = ml_engine_init(NULL);

	if (ret < 0) {
		LOG_ERR("ml_engine_init failed: %d", ret);
		return ret;
	}

	ret = ml_engine_load_model(ML_MODEL_ACTIVITY, MODEL_DATA, MODEL_LEN);
	if (ret < 0) {
		LOG_ERR("load model failed: %d", ret);
		return ret;
	}

	ret = ml_engine_get_io_info(ML_MODEL_ACTIVITY, &in_info, &out_info);
	if (ret < 0) {
		LOG_ERR("get_io_info failed: %d", ret);
		return ret;
	}

	LOG_INF("IN : type=%d bytes=%u   OUT: type=%d bytes=%u",
		in_info.type, (unsigned)in_info.bytes,
		out_info.type, (unsigned)out_info.bytes);

	if (in_info.type != TFLITE_TYPE_INT8 ||
	    out_info.type != TFLITE_TYPE_INT8) {
		LOG_ERR("Model is not int8 (in=%d out=%d)",
			in_info.type, out_info.type);
		return -EINVAL;
	}
	if (in_info.bytes != IN_COUNT * sizeof(int8_t) ||
	    out_info.bytes != ACTIVITY_NUM_CLASSES * sizeof(int8_t)) {
		LOG_ERR("Size mismatch: in=%u (want %u) out=%u (want %u)",
			(unsigned)in_info.bytes,
			(unsigned)(IN_COUNT * sizeof(int8_t)),
			(unsigned)out_info.bytes,
			(unsigned)(ACTIVITY_NUM_CLASSES * sizeof(int8_t)));
		return -EINVAL;
	}
	in_inv_scale = 1.0f / in_info.scale;
	in_zp        = in_info.zero_point;
	out_scale    = out_info.scale;
	out_zp       = out_info.zero_point;

	LOG_INF("in scale=%.6f zp=%d  out scale=%.6f zp=%d",
		(double)in_info.scale, (int)in_zp, (double)out_scale, (int)out_zp);
	return 0;
}

static inline int8_t quantize_i8(float x)
{
	int32_t q = (int32_t)lroundf(x * in_inv_scale) + in_zp;

	if (q > 127)  { q = 127;  }
	if (q < -128) { q = -128; }
	return (int8_t)q;
}

static void activity_thread(void *a, void *b, void *c)
{
	ARG_UNUSED(a); ARG_UNUSED(b); ARG_UNUSED(c);

	static int8_t window[IN_COUNT];
	static int8_t out[ACTIVITY_NUM_CLASSES];

    for (int i = 0; i < 100 && !device_is_ready(accel); i++) {
		k_sleep(K_MSEC(1000));
	}
	if (!device_is_ready(accel)) {
		LOG_ERR("BMI323 not ready");
		return;
	}

	/* A failed model must NOT stop sampling: the recorder depends on it */
	bool model_ok = (activity_model_init() == 0);

	if (!model_ok) {
		LOG_ERR("Model unavailable - sampling only");
	}

	gravity_filter_reset();

	int n = 0;
	struct k_timer tick;

	k_timer_init(&tick, NULL, NULL);
	k_timer_start(&tick, K_MSEC(SAMPLE_PERIOD_MS), K_MSEC(SAMPLE_PERIOD_MS));

	LOG_INF("IMU sampling at %d Hz started", ACC_SAMPLE_HZ);

	for (;;) {
		k_timer_status_sync(&tick);

		struct sensor_value v[3];

		if (sensor_sample_fetch_chan(accel, SENSOR_CHAN_ACCEL_XYZ) < 0 ||
		    sensor_channel_get(accel, SENSOR_CHAN_ACCEL_XYZ, v) < 0) {
			LOG_WRN("accel read failed");
			continue;
		}

		accel3_t raw = {
			.x = sensor_value_to_float(&v[0]),
			.y = sensor_value_to_float(&v[1]),
			.z = sensor_value_to_float(&v[2]),
		};

		/* 1) feed recorder, only while recording (never blocks) */
		if (acc_rec_get_state() == ACC_REC_RECORDING) {
			struct acc_sample s = {
				.t_ms = (uint32_t)k_uptime_get(),
				.x = raw.x, .y = raw.y, .z = raw.z,
			};

			(void)k_msgq_put(&acc_rec_q, &s, K_NO_WAIT);
		}

		/* 2) feed the model */
		if (!model_ok) {
			continue;
		}

		accel3_t p = gravity_suppress_rotate(raw);

		window[n * 3 + 0] = quantize_i8(p.x);
		window[n * 3 + 1] = quantize_i8(p.y);
		window[n * 3 + 2] = quantize_i8(p.z);
		

		if (++n < ACTIVITY_WINDOW_LEN) {
			continue;
		}
		n = 0;

		int irc = ml_engine_invoke(ML_MODEL_ACTIVITY, window, sizeof(window),
					   out, sizeof(out));
       
		if (irc < 0) {
			LOG_ERR("Inference failed");
			continue;
		}

		int best = 0;

		for (int i = 1; i < ACTIVITY_NUM_CLASSES; i++) {
			if (out[i] > out[best]) {
				best = i;
			}
		}

		float pr[ACTIVITY_NUM_CLASSES];

		for (int i = 0; i < ACTIVITY_NUM_CLASSES; i++) {
			pr[i] = ((int32_t)out[i] - out_zp) * out_scale;
		}

		atomic_set(&res_conf, (atomic_val_t)(pr[best] * 100.0f + 0.5f));
		atomic_set(&res_ms,   (atomic_val_t)inf_time_ms);
		atomic_set(&res_idx,  best);
		atomic_inc(&res_seq);

		LOG_INF("%s (%.0f%%) [%.2f %.2f %.2f %.2f]", labels[best],
			(double)(pr[best] * 100.0f),
			(double)pr[0], (double)pr[1], (double)pr[2], (double)pr[3]);
	}
}
K_THREAD_DEFINE(activity_thread_id, ACT_STACK_SIZE , activity_thread, NULL, NULL, NULL, ACT_PRIORITY, 0, 0);
```

## src/activity.h
```c
#ifndef ACTIVITY_H
#define ACTIVITY_H

#include <stdbool.h>
#include <stdint.h>

#define ACT_RES_NONE        (-1)   /* no inference yet */
#define ACT_RES_UNAVAILABLE (-2)   /* model failed to load */

struct activity_result {
	int idx;               /* class index, or ACT_RES_* */
	const char *label;     /* NULL when idx < 0 */
	uint8_t conf_pct;      /* 0..100 */
	uint32_t infer_ms;     /* last ml_engine_invoke() duration */
    uint32_t seq;          /* increments once per new inference */
};

void activity_get_result(struct activity_result *r);

#endif
```

## src/boot.c
```c
/*
 * Hardware bring-up + sensor presence checks. Every result is posted to the boot
 * screen through ui_boot_add(); nothing here touches LVGL directly.
 */
#include <zephyr/kernel.h>
#include <zephyr/device.h>
#include <zephyr/logging/log.h>
#include <zephyr/drivers/gpio.h>
#include <zephyr/drivers/regulator.h>
#include <zephyr/drivers/rtc.h>
#include <zephyr/drivers/sensor.h>
#include <zephyr/dfu/mcuboot.h>
#include <zephyr/sys/timeutil.h>
#include <stdio.h>
#include <stdlib.h>
#include <string.h>
#include <time.h>

#include "max32664c.h"
#include "max32664d.h"
#include "boot.h"
#include "ui.h"
#include "storage.h"
#include "acc_recorder.h"

LOG_MODULE_REGISTER(boot, LOG_LEVEL_DBG);

struct boot_result g_boot;
const struct device *const g_rtc_dev = DEVICE_DT_GET(DT_ALIAS(rtc));

/* ---- Devices ---- */
static const struct device *flash_dev = DEVICE_DT_GET(DT_NODELABEL(w25q01jv));
const struct device *imu_dev = DEVICE_DT_GET(DT_NODELABEL(bmi323));
static const struct device *ecg_dev = DEVICE_DT_GET(DT_ALIAS(max30001));
static const struct device *hub_c_dev = DEVICE_DT_GET_ANY(protocentral_max32664c);
static const struct device *hub_d_dev = DEVICE_DT_GET_ANY(maxim_max32664);

static const struct device *max30208a50_dev = DEVICE_DT_GET(DT_NODELABEL(max30208a50));
static const struct device *max30208a52_dev = DEVICE_DT_GET(DT_NODELABEL(max30208a52));
static const struct device *as6221_dev = DEVICE_DT_GET(DT_NODELABEL(as6221));

static const struct device *ldsw_disp = DEVICE_DT_GET(DT_NODELABEL(npm_pmic_ldo1));
static const struct device *ldsw_fi = DEVICE_DT_GET(DT_NODELABEL(npm_pmic_ldo2));
static const struct device *sensor_rail = DEVICE_DT_GET(DT_NODELABEL(npm_pmic_buck2));
static const struct gpio_dt_spec dcdc_5v_en =
	GPIO_DT_SPEC_GET(DT_NODELABEL(sensor_dcdc_en), gpios);

#define SENSOR_RAIL_OFF_MS    200
#define SENSOR_RAIL_SETTLE_MS 50
#define LED_BOOST_SETTLE_MS   50

/* An nRF reboot leaves BUCK2 + the 5 V boost powered, so a stuck sensor hub stays
 * stuck. Power-cycle both before touching any sensor (same as the base app). */
static void sensor_rail_power_cycle(void)
{
	if (!device_is_ready(sensor_rail)) {
		LOG_ERR("Sensor rail (BUCK2) not ready");
		return;
	}

	gpio_pin_configure_dt(&dcdc_5v_en, GPIO_OUTPUT_INACTIVE);

	if (regulator_disable(sensor_rail) < 0) {
		LOG_ERR("Sensor rail disable failed");
		return;
	}
	k_msleep(SENSOR_RAIL_OFF_MS);

	for (int i = 0; i < 5; i++) {
		if (regulator_enable(sensor_rail) == 0) {
			break;
		}
		k_msleep(10);
	}
	k_msleep(SENSOR_RAIL_SETTLE_MS);

	/* Hold the MAX32664C in reset with MFIO high until its driver inits */
	const struct gpio_dt_spec hub_rst =
		GPIO_DT_SPEC_GET(DT_NODELABEL(max32664c), reset_gpios);
	const struct gpio_dt_spec hub_mfio =
		GPIO_DT_SPEC_GET(DT_NODELABEL(max32664c), mfio_gpios);

	gpio_pin_configure_dt(&hub_mfio, GPIO_OUTPUT_ACTIVE);
	gpio_pin_configure_dt(&hub_rst, GPIO_OUTPUT_INACTIVE);

	gpio_pin_set_dt(&dcdc_5v_en, 1);
	k_msleep(LED_BOOST_SETTLE_MS);
}

static bool try_init(const struct device *dev)
{
	if (dev == NULL) {
		return false;
	}
	(void)device_init(dev);
	k_msleep(100);
	return device_is_ready(dev);
}

static bool probe(const struct device *dev, const char *name, bool critical)
{
	bool ok = try_init(dev);

	if (ok) {
		LOG_INF("%s present", name);
	} else if (critical) {
		LOG_ERR("%s NOT present", name);
	} else {
		LOG_WRN("%s not present", name);
	}

	ui_boot_add(name, ok, true);
	return ok;
}

/* MAX30208 (0x50 or 0x52) on older boards, AS6221 (0x48) on newer ones */
static bool probe_temp_sensor(void)
{
	if (try_init(max30208a50_dev)) {
		LOG_INF("Temp sensor: MAX30208 @0x50");
		ui_boot_add("MAX30208", true, true);
		return true;
	}
	if (try_init(max30208a52_dev)) {
		LOG_INF("Temp sensor: MAX30208 @0x52");
		ui_boot_add("MAX30208", true, true);
		return true;
	}
	if (try_init(as6221_dev)) {
		LOG_INF("Temp sensor: AS6221 @0x48");
		ui_boot_add("AS6221", true, true);
		return true;
	}

	LOG_ERR("No temperature sensor found (MAX30208/AS6221)");
	ui_boot_add("Temp sensor", false, true);
	return false;
}

static void post_version(const char *tag, const struct device *dev, int attr)
{
	struct sensor_value ver;
	char buf[32];

	if (sensor_attr_get(dev, SENSOR_CHAN_ALL, attr, &ver) == 0) {
		LOG_INF("%s App Version: %d.%d", tag, ver.val1, ver.val2);
		snprintf(buf, sizeof(buf), "\t v%d.%d", ver.val1, ver.val2);
		ui_boot_add(buf, true, false);
	}
}


/* If the RTC has never been set (or holds a pre-2025 date), seed it with the
 * firmware build time so the home screen shows something sensible. A valid time
 * left by the base firmware (set over BLE) is kept untouched. */
static void rtc_seed_from_build_time(void)
{
	static const char months[] = "JanFebMarAprMayJunJulAugSepOctNovDec";
	int mon = 0;

	for (int i = 0; i < 12; i++) {
		if (strncmp(__DATE__, months + 3 * i, 3) == 0) {
			mon = i;
			break;
		}
	}

	struct tm tmv = {
		.tm_sec = atoi(__TIME__ + 6),
		.tm_min = atoi(__TIME__ + 3),
		.tm_hour = atoi(__TIME__),
		.tm_mday = atoi(__DATE__ + 4),
		.tm_mon = mon,
		.tm_year = atoi(__DATE__ + 7) - 1900,
	};
	time_t t = timeutil_timegm(&tmv);

	gmtime_r(&t, &tmv); /* fills tm_wday / tm_yday */

	struct rtc_time rt = {
		.tm_sec = tmv.tm_sec,
		.tm_min = tmv.tm_min,
		.tm_hour = tmv.tm_hour,
		.tm_mday = tmv.tm_mday,
		.tm_mon = tmv.tm_mon,
		.tm_year = tmv.tm_year,
		.tm_wday = tmv.tm_wday,
		.tm_yday = tmv.tm_yday,
		.tm_isdst = -1,
		.tm_nsec = 0,
	};

	int rc = rtc_set_time(g_rtc_dev, &rt);

	LOG_WRN("RTC was not set - seeded with build time %s %s (rc %d)", __DATE__, __TIME__, rc);
}

bool boot_run(void)
{
	char buf[32];

#if defined(NRF_TWIM2) && defined(NRF_TWIM1)
	/* nRF5340 anomaly 47 workaround (same as the base firmware) */
	NRF_TWIM2->FREQUENCY = 0x06200000;
	NRF_TWIM1->FREQUENCY = 0x06200000;
#endif

	sensor_rail_power_cycle();

	/* Both LDSWs are boot-off in DT. Hold them off long enough to discharge so
	 * the display is really power-cycled after a warm reboot, then switch on. */
	k_msleep(100);
	if (device_is_ready(ldsw_disp)) {
		regulator_enable(ldsw_disp);
		k_msleep(500);
	} else {
		LOG_ERR("Display LDO not ready");
	}

	/* Start the UI thread and wait (bounded) for the boot screen, so a display
	 * hang cannot block boot. Messages are queued either way. */
	ui_start();
	if (!ui_wait_boot_screen(K_SECONDS(10))) {
		LOG_ERR("Display not ready within 10 s - continuing boot without it");
	}

	/* ---- External flash + LittleFS (recording target) ---- */
	g_boot.flash_ok = device_is_ready(flash_dev);
	ui_boot_add("Flash W25Q", g_boot.flash_ok, true);

	g_boot.fs_ok = g_boot.flash_ok && (storage_init() == 0);

	/* ---- Sensors ---- */
	g_boot.imu_ok = probe(imu_dev, "BMI323", true);
	g_boot.ecg_ok = probe(ecg_dev, "MAX30001", false);

	g_boot.hub_ok = probe(hub_c_dev, "MAX32664C", false);
	if (g_boot.hub_ok) {
		struct sensor_value ids;

		post_version("MAX32664C", hub_c_dev, MAX32664C_ATTR_APP_VER);

		if (sensor_attr_get(hub_c_dev, SENSOR_CHAN_ALL, MAX32664C_ATTR_SENSOR_IDS,
				    &ids) == 0) {
			bool afe = (ids.val1 == MAX32664C_AFE_ID);
			bool acc = (ids.val2 == MAX32664C_ACC_ID);

			ui_boot_add("\t AFE", afe, true);
			ui_boot_add("\t Acc", acc, true);
			g_boot.hub_ok = afe && acc;
		}
	}

	if (device_is_ready(ldsw_fi)) {
		regulator_enable(ldsw_fi);
		k_msleep(100);

		g_boot.fi_ok = probe(hub_d_dev, "MAX32664D", false);
		if (g_boot.fi_ok) {
			post_version("MAX32664D", hub_d_dev, MAX32664D_ATTR_APP_VER);
		}
		regulator_disable(ldsw_fi);
	} else {
		LOG_ERR("Finger sensor regulator (LDO2) not ready");
		ui_boot_add("MAX32664D", false, true);
	}

	g_boot.temp_ok = probe_temp_sensor();

	/* ---- RTC ---- */
	g_boot.rtc_ok = probe(g_rtc_dev, "RTC", true);
	if (g_boot.rtc_ok) {
		struct rtc_time now;

		if (rtc_get_time(g_rtc_dev, &now) != 0 || (now.tm_year + 1900) < 2025) {
			rtc_seed_from_build_time();
		}
	}

	/* ---- Confirm the MCUboot image so it is not reverted on the next reset ---- */
	if (!boot_is_img_confirmed()) {
		if (boot_write_img_confirmed()) {
			LOG_ERR("Failed to confirm image");
		} else {
			LOG_INF("Marked image as OK");
		}
	}

	bool ok = g_boot.imu_ok && g_boot.fs_ok;

	ui_boot_add(ok ? "Boot complete !!" : "Recording unavailable", ok, false);
	ui_boot_complete();
    k_msleep(3000);
   // acc_rec_dump_file("/lfs/acc/acc_0016.csv");
	return ok;
}
```

## src/boot.h
```c
#ifndef BOOT_H
#define BOOT_H

#include <zephyr/kernel.h>
#include <zephyr/device.h>
#include <stdbool.h>

struct boot_result {
	bool flash_ok; /* external W25Q flash */
	bool fs_ok;    /* LittleFS mounted - required for recording */
	bool imu_ok;   /* BMI323 - required for recording */
	bool ecg_ok;   /* MAX30001 */
	bool hub_ok;   /* MAX32664C wrist hub (+ AFE/accel IDs) */
	bool fi_ok;    /* MAX32664D finger hub */
	bool temp_ok;  /* MAX30208 / AS6221 */
	bool rtc_ok;   /* RTC - home screen time */
};

extern struct boot_result g_boot;
extern const struct device *const g_rtc_dev;

/* Rails, display, sensor checks, filesystem. Blocks until finished; the UI
 * thread then switches to the home screen on its own. Returns true when
 * everything needed for recording (IMU + LittleFS) is present. */
bool boot_run(void);

#endif
```

## src/gravity_filter.c
```c
/*
 * Adapted from STMicroelectronics filter_gravity.c (AIS - MCD Team).
 * 4th-order IIR high-pass (coefficients designed for 26 Hz, as used by ST in
 * both training and firmware), transposed direct form II.
 */
#include <math.h>
#include "gravity_filter.h"

#define N_COEF   5
#define N_STATE  (N_COEF - 1)

// Hi-pass IIR filter to separate the low-varying signal
/* For 20HZ */
static const float A[N_COEF] = {1.0, -3.83582554, 5.52081914, -3.53353522, 0.848556};
static const float B[N_COEF] = {0.92117099, -3.68468397, 5.52702596, -3.68468397, 0.92117099};

/* Steady-state init (scaled by the first sample) -> no start-up transient */
static const float Z_INIT[N_STATE] = {
	-0.936528250873f, 2.809571532101f, -2.809559172096f, 0.936515859573f
};

struct hp_filter {
	float z[N_STATE];
};

static struct hp_filter hp[3];
static int first_sample = 1;

void gravity_filter_reset(void)
{
	first_sample = 1;
}

static void hp_init(struct hp_filter *f, float first)
{
	float scale = (first == 0.0f) ? 1.0f : first;

	for (int i = 0; i < N_STATE; i++) {
		f->z[i] = scale * Z_INIT[i];
	}
}

static float hp_step(struct hp_filter *f, float x)
{
	float y = B[0] * x + f->z[0];

	for (int i = 1; i < N_STATE; i++) {
		f->z[i - 1] = f->z[i] + B[i] * x - A[i] * y;
	}
	f->z[N_STATE - 1] = B[N_STATE] * x - A[N_STATE] * y;

	return y;
}

accel3_t gravity_suppress_rotate(accel3_t in)
{
	if (first_sample) {
		hp_init(&hp[0], in.x);
		hp_init(&hp[1], in.y);
		hp_init(&hp[2], in.z);
		first_sample = 0;
	}

	/* dynamic acceleration = high-passed signal, gravity = the rest */
	float dx = hp_step(&hp[0], in.x);
	float dy = hp_step(&hp[1], in.y);
	float dz = hp_step(&hp[2], in.z);

	float gx = in.x - dx;
	float gy = in.y - dy;
	float gz = in.z - dz;

	float gm2 = gx * gx + gy * gy + gz * gz;
	accel3_t out = { dx, dy, dz };

	if (gm2 < 1e-12f) {
		return out;                      /* no gravity estimate yet */
	}

	float inv = 1.0f / sqrtf(gm2);
	gx *= inv;
	gy *= inv;
	gz *= inv;

	float s2 = 1.0f - gz * gz;
	float sin_t = (s2 > 0.0f) ? sqrtf(s2) : 0.0f;
	float cos_t = -gz;

	/* rotation axis = z x g, normalised (0 if gravity is along z) */
	float vx = 0.0f, vy = 0.0f;

	if (sin_t > 1e-6f) {
		vx = -gy / sin_t;
		vy = gx / sin_t;
	} else {
		sin_t = 0.0f;
	}

	/* Rodrigues' rotation of the dynamic acceleration */
	float vf = (vx * dx + vy * dy) * (1.0f - cos_t);

	out.x = dx * cos_t + vy * dz * sin_t + vx * vf;
	out.y = dy * cos_t - vx * dz * sin_t + vy * vf;
	out.z = dz * cos_t + (vx * dy - vy * dx) * sin_t;

	return out;
}
```

## src/gravity_filter.h
```c
/*
 * Gravity suppression + rotation for ST HAR models (st_gmp / st_ign).
 * Port of ST's filter_gravity.c (stm32ai-modelzoo-services, Dpu/Src) and the
 * Python training code (preprocessing.py: gravity_rotation).
 *
 * Input  : raw accelerometer in m/s^2 (what Zephyr's sensor API returns).
 *          ST's firmware scales raw data to m/s^2 before this filter.
 * Output : dynamic (gravity-free) acceleration rotated so gravity points
 *          along the z axis, same unit as the input.
 *
 * Call once per sample, in time order, at the model's sample rate.
 */
#ifndef GRAVITY_FILTER_H
#define GRAVITY_FILTER_H

typedef struct {
	float x;
	float y;
	float z;
} accel3_t;

/* Forget the filter history; next sample re-initialises the filter. */
void gravity_filter_reset(void);

accel3_t gravity_suppress_rotate(accel3_t in);

#endif /* GRAVITY_FILTER_H */
```
