/*
 * Copyright (c) 2023 Nordic Semiconductor ASA
 * SPDX-License-Identifier: LicenseRef-Nordic-5-Clause
 */

.param_1 = {0.0, 0.005, 0.01, 0.015, 0.02, 0.025, 0.03, 0.035, 0.04, 0.045, 0.05, 0.055, 0.06, 0.065, 0.07, 0.075, 0.08, 0.085, 0.09, 0.095, 0.1, 0.105, 0.11, 0.115, 0.12, 0.125, 0.13, 0.135, 0.14, 0.145, 0.15, 0.155, 0.16, 0.165, 0.17, 0.17500000000000002, 0.18, 0.185, 0.19, 0.195, 0.2, 0.20500000000000002, 0.21, 0.215, 0.22, 0.225, 0.23, 0.23500000000000001, 0.24, 0.245, 0.25, 0.255, 0.26, 0.265, 0.27, 0.275, 0.28, 0.28500000000000003, 0.29, 0.295, 0.3, 0.305, 0.31, 0.315, 0.32, 0.325, 0.33, 0.335, 0.34, 0.34500000000000003, 0.35000000000000003, 0.355, 0.36, 0.365, 0.37, 0.375, 0.38, 0.385, 0.39, 0.395, 0.4, 0.405, 0.41000000000000003, 0.41500000000000004, 0.42, 0.425, 0.43, 0.435, 0.44, 0.445, 0.45, 0.455, 0.46, 0.465, 0.47000000000000003, 0.47500000000000003, 0.48, 0.485, 0.49, 0.495, 0.5, 0.505, 0.51, 0.515, 0.52, 0.525, 0.53, 0.535, 0.54, 0.545, 0.55, 0.555, 0.56, 0.5650000000000001, 0.5700000000000001, 0.5750000000000001, 0.58, 0.585, 0.59, 0.595, 0.6, 0.605, 0.61, 0.615, 0.62, 0.625, 0.63, 0.635, 0.64, 0.645, 0.65, 0.655, 0.66, 0.665, 0.67, 0.675, 0.68, 0.685, 0.6900000000000001, 0.6950000000000001, 0.7000000000000001, 0.705, 0.71, 0.715, 0.72, 0.725, 0.73, 0.735, 0.74, 0.745, 0.75, 0.755, 0.76, 0.765, 0.77, 0.775, 0.78, 0.785, 0.79, 0.795, 0.8, 0.805, 0.81, 0.8150000000000001, 0.8200000000000001, 0.8250000000000001, 0.8300000000000001, 0.835, 0.84, 0.845, 0.85, 0.855, 0.86, 0.865, 0.87, 0.875, 0.88, 0.885, 0.89, 0.895, 0.9, 0.905, 0.91, 0.915, 0.92, 0.925, 0.93, 0.935, 0.9400000000000001, 0.9450000000000001, 0.9500000000000001, 0.9550000000000001, 0.96, 0.965, 0.97, 0.975, 0.98, 0.985, 0.99, 0.995, 1.0},
.temps = {5.0, 25.0, 45.0},
.param_2 = {2.79, 2.8016528925619837, 2.813305785123967, 2.8249586776859505, 2.8366115702479338, 2.8482644628099174, 2.859917355371901, 2.8715702479338843, 2.883223140495868, 2.894876033057851, 2.906528925619835, 2.918181818181818, 2.9298347107438016, 2.9414876033057853, 2.9531404958677685, 2.964793388429752, 2.976446280991736, 2.988099173553719, 2.9997520661157027, 3.011404958677686, 3.0230578512396695, 3.0347107438016527, 3.0463636363636364, 3.05801652892562, 3.0696694214876032, 3.081322314049587, 3.0929752066115705, 3.1046280991735538, 3.1162809917355374, 3.1279338842975206, 3.1395867768595043, 3.1512396694214875, 3.162892561983471, 3.174545454545455, 3.186198347107438, 3.1978512396694216, 3.209504132231405, 3.2211570247933885, 3.2328099173553717, 3.2444628099173554, 3.256115702479339, 3.267768595041322, 3.279421487603306, 3.2910743801652895, 3.3027272727272727, 3.3143801652892564, 3.3260330578512396, 3.3376859504132232, 3.3493388429752065, 3.36099173553719, 3.3726446280991738, 3.384297520661157, 3.3959504132231406, 3.4076033057851243, 3.4192561983471075, 3.430909090909091, 3.4425619834710743, 3.454214876033058, 3.465867768595041, 3.477520661157025, 3.4891735537190085, 3.5008264462809917, 3.5124793388429754, 3.524132231404959, 3.5357851239669422, 3.5474380165289254, 3.559090909090909, 3.5707438016528927, 3.582396694214876, 3.5940495867768596, 3.6057024793388432, 3.6173553719008265, 3.62900826446281, 3.6406611570247933, 3.652314049586777, 3.66396694214876, 3.675619834710744, 3.6872727272727275, 3.6989256198347107, 3.7105785123966943, 3.722231404958678, 3.733884297520661, 3.745537190082645, 3.757190082644628, 3.7688429752066117, 3.780495867768595, 3.7921487603305786, 3.8038016528925622, 3.8154545454545454, 3.827107438016529, 3.8387603305785127, 3.850413223140496, 3.862066115702479, 3.873719008264463, 3.8853719008264465, 3.8970247933884297, 3.9086776859504133, 3.920330578512397, 3.93198347107438, 3.943636363636364, 3.9552892561983475, 3.9669421487603307, 3.978595041322314, 3.9902479338842975, 4.001900826446281, 4.013553719008264, 4.025206611570248, 4.036859504132232, 4.048512396694215, 4.060165289256198, 4.071818181818182, 4.083471074380165, 4.095123966942149, 4.106776859504132, 4.118429752066116, 4.130082644628099, 4.141735537190083, 4.1533884297520665, 4.16504132231405, 4.176694214876033, 4.188347107438016, 4.2},
.param_3 = {0.008143199138758172, 0.0011146766417105703, -0.001571184650254782, -0.0018210187418425056, -0.0015097505223363936, -0.001424772698908698, -0.0013068230481761585, -0.0012172316827705092, -0.0011363372297274901, -0.0010605497642476249, -0.0009848396741753526, -0.0008981114302519559, -0.0007951203881806209, -0.0006660845899837382, -0.0005174721328357906, -0.0003710009896256828, -0.00025060911681478826, -0.00016625586803078947, -0.00011186404427695616, -7.871951412087119e-05, -5.919744998903027e-05, -4.7717361933873704e-05, -4.096309107227591e-05, -3.749216692351711e-05, -3.77909408928164e-05, -4.093379623964394e-05, -4.7297776740391866e-05, -5.833883930057298e-05, -7.33499265319716e-05, -9.338547491352605e-05, -0.00011833111438276963, -0.00014520798659501202, -0.00016964725674286708, -0.00018820652081213198, -0.00020077516266257066, -0.0002066951847150912, -0.00020730601388835266, -0.00020439953302878576, -0.00020261603620085695, -0.00020210150179262925, -0.00020280695796809126, -0.00020414668814052443, -0.00020441366530878427, -0.0002045000697906182, -0.00020408540404040002, -0.00020333167116906467, -0.00020002929012282423, -0.00019348621405672345, -0.00018920666235611085, -0.00018273348125101587, -0.00017569879085633995, -0.00017631837722658362, -0.00018106918291092635, -0.00018533899328081492, -0.00018835256430179784, -0.0001911004558460017, -0.000193927491595688, -0.0001962371906067796, -0.00019746928670680156, -0.00019744810949328342, -0.00019609990357910922, -0.00019338079600266555, -0.00018922326687745075, -0.00018363556223508442, -0.00017683024142287212, -0.00016902193633327038, -0.00016011756412756417, -0.00014984813479386813, -0.000138008515486415, -0.00012452044492067792, -0.00010932905466273228, -9.245556621139274e-05, -7.396489791607866e-05, -5.4280563221050414e-05, -3.438437480665612e-05, -1.527945454447739e-05, 2.1589837806216456e-06, 1.7099405177375087e-05, 2.8983315412684517e-05, 3.763996001086679e-05, 4.3003758465869844e-05, 4.53847647811464e-05, 4.5217830938085325e-05, 4.294778165605756e-05, 3.898546869831885e-05, 3.3727259963960797e-05, 2.7548473011507625e-05, 2.0820876820705774e-05, 1.3799014025942496e-05, 6.595927225941088e-06, -5.762456336310066e-07, -7.36434741796924e-06, -1.346376070470211e-05, -1.9183745366179675e-05, -2.5281863630171244e-05, -3.211924025411593e-05, -3.91602379064211e-05, -4.579560791698776e-05, -5.144281465188022e-05, -5.536575535070626e-05, -5.709238874253641e-05, -5.71867059376701e-05, -5.643435288818217e-05, -5.5133113385751284e-05, -5.318839095802236e-05, -5.070189936318767e-05, -4.799017564080996e-05, -4.528854696396483e-05, -4.2332098083251814e-05, -3.881900489535283e-05, -3.5522506531124875e-05, -3.380036505564048e-05, -3.378411591476907e-05, -3.4252336096684355e-05, -3.4210475796778834e-05, -3.3759679736020156e-05, -3.31805178190617e-05, -3.276788299287344e-05, -3.2910134889870014e-05, -3.381907248406187e-05, -3.5338747016081527e-05, -3.727739806066262e-05, -3.9456544694670996e-05, -4.177392929341453e-05, -4.42677373969416e-05, -4.710591143210824e-05, -5.046323143686182e-05, -5.4531465559942394e-05, -5.959148130496002e-05, -6.614326543769549e-05, -7.483321431509195e-05, -8.631112826889703e-05, -0.00010091879324285954, -0.00011785164788426049, -0.00013573712054992066, -0.000153048982279846, -0.000168260438358823, -0.0001803237390008927, -0.00018955079051177269, -0.00019629757848576887, -0.0002008557251414264, -0.000203517073241506, -0.0002046448980597553, -0.00020468606316089357, -0.0002038458210937371, -0.0002022790626773167, -0.0002001409641380352, -0.00019762362257979467, -0.00019496018907536815, -0.0001923294043705574, -0.00018990280909361856, -0.00018784593596035543, -0.0001859106310760178, -0.00018351919366634727, -0.00018049192770358498, -0.0001766787574776674, -0.00017193224871818433, -0.0001662110306591624, -0.00015947330744436284, -0.00015155677666460962, -0.00014229510304673094, -0.0001315281759417504, -0.00011934605691680472, -0.00010666805984704427, -9.476294983076051e-05, -8.490290896804536e-05, -7.831797622067872e-05, -7.537047578434694e-05, -7.570093292063549e-05, -7.896030075011707e-05, -8.47995782899405e-05, -9.290027499152049e-05, -0.0001032717826258608, -0.00011577519028742823, -0.00013016678735837785, -0.00014620286322043855, -0.00016364544784191673, -0.00018228320326037998, -0.00020185258964820145, -0.00022207760636319378, -0.00024268225276316037, -0.0002634166197661158, -0.0002842949190747475, -0.00030549541040184936, -0.0003272000527742084, -0.00034959080521855047, -0.00037283543922965153, -0.00039697950755365904, -0.00042200121352798775, -0.0004478776574696866, -0.00047458593969586146, -0.000502136246015011, -0.000530857459066841, -0.0005612621925090933, -0.0005938655190307547, -0.0006291825113205288, -0.0006677282420674447, -0.0007100177839602571, -0.0007565662096879442, -0.0008078885919392088, -0.0008645000034030291},
.param_4 = {1.9054557853365603, 2.761846902915545, 3.1217102570725364, 3.213866436939183, 3.2404837744243773, 3.2780111800358673, 3.307568392863341, 3.334029513923727, 3.3581011407653625, 3.3796331963443356, 3.3990143466855387, 3.41606556087737, 3.4307542634571533, 3.4427469637517727, 3.4523071005070083, 3.459829387592006, 3.4659665873970646, 3.471212989997922, 3.47586793309397, 3.4800980066955978, 3.4838644135691843, 3.487276054443082, 3.490519401689803, 3.4936596801195328, 3.496628433631791, 3.4995277420943713, 3.5024487812966467, 3.5054674104056933, 3.5086138557243642, 3.51196421411735, 3.51556467515111, 3.519404100643714, 3.5233918893077854, 3.527415666809465, 3.5314328191027444, 3.5353443342341953, 3.5391709539261433, 3.5429445423890136, 3.546714421750315, 3.5504581004143025, 3.554162168237007, 3.5578131390811016, 3.561400504039457, 3.5650032009006387, 3.5685411372408873, 3.5720190901756093, 3.5754466513396257, 3.578752701729405, 3.5820174681447, 3.585129335533748, 3.588160411130544, 3.5914228439383686, 3.594791495097488, 3.598116988921053, 3.6013628350052542, 3.6045990771918732, 3.6078375264166347, 3.6110969499022, 3.614390575176786, 3.617673301487499, 3.620976831231542, 3.624339642711648, 3.627728189761743, 3.631136136960225, 3.6345825500598767, 3.6380793007015044, 3.64161597598994, 3.6451858633938543, 3.648784804251187, 3.652413647301412, 3.656071661309137, 3.659768756570787, 3.6635075014748204, 3.667255217920839, 3.6710824729779565, 3.675032083319352, 3.679074170322289, 3.6832001871965945, 3.6874171437361505, 3.691723690382416, 3.6961130271576925, 3.700578648397043, 3.7051176137474404, 3.70971885835528, 3.7143640744735817, 3.7190494234582747, 3.7237894167685814, 3.728581774653152, 3.733399423270242, 3.738224988407801, 3.7430538620694316, 3.747876101601463, 3.752679961174711, 3.75746454855021, 3.762235161583808, 3.7669869422263513, 3.771698901977553, 3.776349520330291, 3.780919537225382, 3.7853890968997095, 3.789741534291509, 3.793972856542724, 3.798090507074063, 3.802099623913779, 3.8059936332558535, 3.8097708947195366, 3.8134384505386563, 3.817002573919136, 3.820464206246616, 3.8238294915264817, 3.8271356992258934, 3.830429662230897, 3.8337140954364726, 3.836949341707538, 3.8401069456005876, 3.843199747100546, 3.8462479946414314, 3.8492723259208024, 3.8522935923779364, 3.8553241297848704, 3.8583596922342926, 3.86139308693224, 3.8644198544783244, 3.867439147655725, 3.8704651358609614, 3.873524761272885, 3.876613605797777, 3.879696413838954, 3.8827746349997594, 3.885899352076095, 3.8891295284635286, 3.8925238873355807, 3.896120217517954, 3.8999174948647917, 3.9038977152244296, 3.9080370077727493, 3.912313456268942, 3.9167142001698463, 3.921241434091282, 3.925892235705342, 3.930662530337763, 3.9355511066388646, 3.940557961305168, 3.945681717908401, 3.950910692108374, 3.956230246888277, 3.961625575251248, 3.9670822926610727, 3.97257552988735, 3.978043076537137, 3.9834148538358773, 3.9886207129167057, 3.9935940272857873, 3.998309780692701, 4.00276978515942, 4.006976988472656, 4.010934187914756, 4.014644147469101, 4.018105051490413, 4.021310161495623, 4.024254571274661, 4.026947855620141, 4.029410625867709, 4.031689711389984, 4.033844407978273, 4.035928237815923, 4.037990977671813, 4.040072847932803, 4.042208602218797, 4.044428969022002, 4.046761036453258, 4.0492321775430105, 4.051869531279097, 4.054684382297219, 4.057683730084726, 4.060874574568677, 4.064263853542154, 4.067854538202017, 4.071643121540547, 4.075625445614235, 4.079797411453447, 4.084157490146883, 4.0887106987198765, 4.093464957304956, 4.098428254629859, 4.103606251496256, 4.10900069447556, 4.114610936053338, 4.120434951946931, 4.126471619014923, 4.132721676359959, 4.139187106534037, 4.145880622717271, 4.152821568621825, 4.160029743896261, 4.167525003688074, 4.175327203144765, 4.183456197413829, 4.19193184164277, 4.20077399097908, 4.210002500570262},
.param_5 = {171.2782235157969, 121.62544717359759, 45.20195340236381, 11.877351735184094, 6.414474309668439, 6.708461843896352, 5.601833388785948, 5.053274790202167, 4.560368242060875, 4.091320592017622, 3.6432364533034445, 3.1739916771614585, 2.668140287440268, 2.1552837049855, 1.7082423840233396, 1.365948689005636, 1.1383602405915738, 0.9901345696905484, 0.888501669767594, 0.7996480475214174, 0.7178047747484317, 0.6654988120618821, 0.6383625676450677, 0.6109031941988086, 0.5868061974838579, 0.5820347664855507, 0.5939668311321977, 0.6165074427717521, 0.6496803711656618, 0.6950819426745802, 0.743988652636407, 0.7827214156675311, 0.8011566165750938, 0.8040929794959073, 0.7928667424730307, 0.7738134823398912, 0.7600208154818322, 0.7543467824171479, 0.7513558025288969, 0.7447746486691997, 0.7355038666799096, 0.7238335802450369, 0.7190061819537075, 0.7140633201430102, 0.7015889274970544, 0.6905514098738408, 0.6733611553795704, 0.6570816805074209, 0.6376633804343168, 0.6142942985844169, 0.6293508404620507, 0.6631083966944118, 0.6694144982684502, 0.6571339907766038, 0.6482088270820086, 0.6474691411380462, 0.6497872710326646, 0.6553048760151281, 0.6576351585299012, 0.6586256054756046, 0.6666341224148997, 0.6751358530201035, 0.6796494248577201, 0.6854360298133688, 0.6943163741279346, 0.7033425930063064, 0.7106562692349883, 0.7168828261247207, 0.722778390755785, 0.7286857057950069, 0.7355109269374882, 0.7435840165683327, 0.7486461350052043, 0.757497150313613, 0.7776865398513078, 0.7991697344332582, 0.8168103877242316, 0.8342973413861365, 0.8523503185821735, 0.8695883421542039, 0.8854958014626657, 0.9004586589747898, 0.9140209958236944, 0.9246460726141326, 0.9330565102994903, 0.9425342294999695, 0.9532351194877275, 0.961000650166044, 0.964321375464916, 0.9654438799189702, 0.9651113193661853, 0.9626099105279451, 0.9588446948746832, 0.9555200409097075, 0.9522393676141494, 0.9463740393744757, 0.93625781039397, 0.9220635247829012, 0.903957656941845, 0.8821997066127185, 0.8583759643014499, 0.8348972782553865, 0.8126767371054999, 0.7903126181790565, 0.767127080575758, 0.7444817282802774, 0.7231679199599661, 0.7025755707959824, 0.682691760734544, 0.6671492979277271, 0.6600170704415209, 0.6578396210579207, 0.6519679476641116, 0.639285016411506, 0.625040539300814, 0.6141049040843782, 0.6072578820256247, 0.6045597736505037, 0.6051803864068006, 0.60660998563562, 0.6068957147369769, 0.6060162244031719, 0.6046060723484903, 0.6045281382637047, 0.6085613617159868, 0.6148469936815726, 0.6171652566068886, 0.6161029201982249, 0.6202938237141353, 0.6354893463769162, 0.6624535259485587, 0.699068905442557, 0.7393607529210922, 0.7777497706475511, 0.8119512907957649, 0.8415741044512259, 0.8677192397096967, 0.8927977822339894, 0.9178035535495788, 0.9421096246481131, 0.9658870933522579, 0.9895430967405083, 1.0130611269536516, 1.035273080320609, 1.0548528979875904, 1.0714883142874054, 1.0852045772795638, 1.0949954636101822, 1.0960783876064362, 1.083932394852738, 1.0577636379568656, 1.0179173449909928, 0.9689067775995319, 0.9175757873632673, 0.8667207779954555, 0.8164402755336475, 0.7667158996444989, 0.7170863575656661, 0.6666014026522227, 0.614951978424827, 0.5637694124517978, 0.5156054593047799, 0.47418557698435393, 0.44337821105635555, 0.42385264259383604, 0.4146569693539881, 0.41446101168807203, 0.42176245469844886, 0.43561210891986946, 0.4552434234461167, 0.4803208521008351, 0.5108494825838861, 0.5452204754208267, 0.5814198805628834, 0.619019227145845, 0.6580123457427867, 0.6979963633339636, 0.7379267998393502, 0.7770907412218087, 0.8154289912900126, 0.8532044532648442, 0.8913287266429037, 0.9307467158072846, 0.9717555909982245, 1.0141294191299721, 1.0572439845700998, 1.1004684557081923, 1.1434257471371723, 1.186068296158549, 1.2286724413027805, 1.2715487519114, 1.3158946357311407, 1.3634462087787291, 1.4149121178990143, 1.4703435066249604, 1.5297459248504452, 1.5931193725754689, 1.6604638498004753, 1.7317793565251094, 1.8070658927491934, 1.8457019182363865},
.param_6 = {-1.4057044994095202, -0.9714383789012954, -0.2935695383553076, 0.006143412791838852, 0.03962460429338076, 0.020292747416023504, 0.020754101613818875, 0.017048581844866836, 0.015668191852288436, 0.01514975555521375, 0.0162438333995669, 0.01897192859947318, 0.02320268402682176, 0.027764825534483027, 0.029508360035805543, 0.026686301602100233, 0.02047451215948933, 0.01387450725378321, 0.008753635390991828, 0.005266659428792589, 0.0031002152186997483, 0.0018234358916754364, 0.0010225195010356595, 0.00031721501794595086, -0.0003441629316126828, -0.0009506835847575465, -0.0017405043060929042, -0.0026052149791579724, -0.003504663561295307, -0.004498118785079804, -0.005182251168148596, -0.005131614236009744, -0.004299853421711996, -0.003112790591970358, -0.0018488663902959208, -0.0006530851225782007, 0.00022956516863054284, 0.0004689977687495709, 0.0002298031236156508, -1.909217672343012e-05, -0.0002045186347895175, -0.00016067073406930146, -3.533816500937725e-05, 3.282612683842476e-05, 0.00011683986215535306, 0.0004056113917575788, 0.0009845457112341222, 0.001082262776671338, 0.0010752732805707575, 0.00135078714997709, 0.0006415104024432255, -0.0005370392054586398, -0.0009020616054231301, -0.0007283381390871485, -0.0005761462565186771, -0.0005574927293890163, -0.0005136734760777923, -0.00035417951111135586, -0.00012109188865038032, 0.00013693831276923387, 0.00040673134906178644, 0.0006876636701658471, 0.0009745233767581135, 0.0012393025454578632, 0.0014613625901814037, 0.0016712677295307944, 0.0019173801539402247, 0.002210904864114916, 0.002532768987319021, 0.0028679460823682734, 0.003206487870928518, 0.0035364156746653616, 0.003817500299034232, 0.003958052310942255, 0.003900110867657303, 0.0036543358587277763, 0.0032378859721852475, 0.0026824331632062867, 0.0020540554833491705, 0.0014020443053185327, 0.0007744804770279611, 0.00022140724722154807, -0.00024369831250888404, -0.0006232362239766472, -0.0009220521692096765, -0.0011436995686811226, -0.0012906383143255022, -0.0013749458985565129, -0.0014224949594764686, -0.0014375259659573502, -0.0013960274643910328, -0.0012887515071071103, -0.0011819397948210435, -0.0011818102925469135, -0.001293549488793625, -0.001387837427624986, -0.001367636766287183, -0.0012282576745459117, -0.0009570147433718504, -0.0005649574090656191, -0.0001820950586963839, 6.580358543542412e-05, 0.00020535925519188163, 0.0003245961930159815, 0.00044312140225636135, 0.0005198215317212397, 0.0005413352399222843, 0.0005658077557558147, 0.0006469542068611998, 0.0006809591552126939, 0.0005018639839712346, 0.00017383906163558055, -4.519710410438716e-05, -4.263598820097644e-05, 4.926563606641988e-05, 0.00010299579777171318, 9.917967431467164e-05, 2.70382929191688e-05, -0.00010511894911884338, -0.00024286121262115127, -0.0003458325576600747, -0.000411779767858947, -0.00044965312327519127, -0.00048111927022706025, -0.0005331982138693709, -0.0006195494039920224, -0.0007425554127834151, -0.0009128249868098195, -0.001161179987775309, -0.0015241733010131933, -0.0020167862831201545, -0.002608557892776759, -0.003154051961536346, -0.0034818327307061126, -0.0035197334395585516, -0.0032523317808902334, -0.00272747567210467, -0.0021290352152949685, -0.0015973839484876163, -0.0011304934629653711, -0.0007219494755737125, -0.00037891729183289074, -0.00011689899193875774, 7.990769660181979e-05, 0.00024070004835768618, 0.000370485695570192, 0.00046554400975220395, 0.0005180775062667043, 0.0005294218209237281, 0.0005057379981749586, 0.00044834684102019605, 0.00039921780176007673, 0.000432674229400816, 0.0005418703372432815, 0.0006840436188679884, 0.0008559678985400643, 0.0010467726818504993, 0.0012458941273821495, 0.001465425399455278, 0.0017178204397631895, 0.002002860072285921, 0.0022949046129926223, 0.0024860116094706126, 0.002458310708604421, 0.0021765150878998918, 0.001644497361008179, 0.0009532433183698414, 0.00026170433000432305, -0.00035898249657701306, -0.0009098645369305007, -0.0013939974241403415, -0.0018472204335920302, -0.002287491529590773, -0.0026895004732517052, -0.003042767293301033, -0.0033478660483538883, -0.003608034003994143, -0.0038207141806284716, -0.00397944031028138, -0.004082966311495892, -0.004133901340292201, -0.004161266631158712, -0.004207879063573356, -0.004290513369946088, -0.0044095394816701106, -0.004563538645544315, -0.004738870233510857, -0.004916577429833622, -0.005089814991602757, -0.005258472616787371, -0.00542585885453244, -0.005627151937097953, -0.005912594649408226, -0.006300805996391375, -0.006792031881143554, -0.007386272303668994, -0.00808352726397283, -0.008883796762049949, -0.009787080797895167, -0.010793379371508493, -0.011322282292764059},
.param_7 = {-7.690236708175416e-06, -6.469743436821721e-06, -5.249250165468092e-06, -4.02875689411443e-06, -2.808263622760734e-06, -1.5877703514071054e-06, -3.6727708005337614e-07, 8.532161913002861e-07, 2.073709462653982e-06, 3.294202734007577e-06, 4.514696005361272e-06, 5.735189276714834e-06, 6.95568254806853e-06, 8.17617581942226e-06, 9.396669090775887e-06, 1.0617162362129516e-05, 1.1837655633483246e-05, 1.3058148904836941e-05, 1.4278642176190636e-05, 1.549913544754423e-05, 1.6719628718897928e-05, 1.7940121990251455e-05, 2.1273094743458695e-05, 3.214529720414156e-05, 4.301749966482392e-05, 5.388970212550675e-05, 6.476190458618958e-05, 7.563410704687183e-05, 7.859579619727299e-05, 7.988628858408487e-05, 8.117678097089692e-05, 9.747027232673884e-05, 0.00012742354747171346, 0.0001573768226166883, 0.0001821738659442173, 0.00020379761099173296, 0.00022542135603924792, 0.00023219400193123685, 0.0002067479254247105, 0.00019453926358180292, 0.000199904596438462, 0.00021051508755761671, 0.0002196402360731162, 0.00022091661885782475, 0.00022454191444211969, 0.00022582017106957761, 0.000230214799893338, 0.00023313157082908618, 0.00023801902690165976, 0.00024176618510165406, 0.00024508294988302573, 0.0002475658856961891, 0.00024943296208704757, 0.00024875240345596745, 0.00024577119535174947, 0.00023983531544257677, 0.00022705983016138055, 0.00020097141918628815, 0.00015957877522071223, 0.00010050323099232815, 6.747987249896709e-05, 0.00010046781327791204, 0.0001994119465215991, 0.00024869609208328226, 0.0002645895027221032, 0.0002799027025135813, 0.0002874432864344827, 0.00028792460056742034, 0.00028855754880763085, 0.0003012384924313795, 0.00030759537283666554, 0.00028538404703824, 0.00024391612387431033, 0.00019157510136672638, 0.00012747470793813073, 5.7196203737878794e-05, -3.5417988230717964e-06, -4.11133569241961e-05, -5.179386686152443e-05, -4.316274903622471e-05, -2.535637834587046e-05, -5.649406566737716e-06, 1.2060667156134607e-05, 2.801860770308952e-05, 4.760560149147582e-05, 6.28442330338648e-05, 6.655559072017628e-05, 6.47728461771521e-05, 5.8915333094581974e-05, 4.978414018776043e-05, 5.321981532140153e-05, 5.40991366056016e-05, 6.529159755656618e-05, 8.231089777758607e-05, 0.00011618278598128224, 0.0001811290024687363, 0.00021454867731536604, 0.00021567300870909559, 0.0002066208535776917, 0.00019773100247700754, 0.0001916627516032567, 0.00019006647823539935, 0.00019654940127330754, 0.00020794437216414529, 0.00021620621952932447, 0.00021464002988604277, 0.0001908073703062785, 0.000173354889336089, 0.00023122181225003667, 0.00029775353436966483, 0.0003423045797947588, 0.0003703367380174316, 0.00039391642819920365, 0.00041503796387553043, 0.00043374045537937386, 0.00045174860358818656, 0.0004699123293913408, 0.0004894709561301396, 0.0005114004599243774, 0.00033834525067898575, 0.00016577886085391994, 2.63108349253107e-06},
.param_8 = {0.0053171262294875845, 0.005439563326618576, 0.005562000423749562, 0.005684437520880555, 0.005806874618011542, 0.005929311715142536, 0.006051748812273528, 0.006174185909404513, 0.006296623006535508, 0.006419060103666495, 0.006541497200797488, 0.006663934297928476, 0.006786371395059469, 0.00690880849219046, 0.007104534590936186, 0.007309839782980122, 0.007515144975024054, 0.00772045016706798, 0.007925755359111913, 0.008131060551155846, 0.008336365743199774, 0.008541670935243707, 0.008722330533332684, 0.008815032451501111, 0.008907734369669533, 0.00900043628783796, 0.009093138206006386, 0.00939002710082726, 0.010090626972135868, 0.0108552893860487, 0.011619951799961557, 0.012188885352853292, 0.012593324397479455, 0.012997763442105605, 0.013462358524601935, 0.014032912273362237, 0.014635057326979142, 0.015810220358128402, 0.01845430246277079, 0.02063202879616856, 0.02214925271823559, 0.023646601069735932, 0.02524594425550413, 0.027209354530463192, 0.029211502169554805, 0.031331660355650985, 0.033522555947571364, 0.03580134224355014, 0.038197185218778865, 0.040687181638420396, 0.04339265394069359, 0.04621619184599516, 0.04926867704326591, 0.052610872075183265, 0.05623352352425468, 0.060285935870942046, 0.06513370034199578, 0.07129868038100438, 0.0796629422016055, 0.09189169579086155, 0.10825345886992753, 0.12700936155360112, 0.14469661296428457, 0.16062500360279605, 0.1756954651087832, 0.19083312763481994, 0.20673984388633437, 0.22319910536441817, 0.2406790802813158, 0.2585874401608392, 0.2766199820386534, 0.2946924151162537, 0.31225454772429906, 0.32917922757817664, 0.34556234123005, 0.3613718781766084, 0.3764282921346374, 0.3904492031023947, 0.40359912142666277, 0.4161427657680913, 0.4283293684360459, 0.44035659324310855, 0.45228780733085555, 0.46435446881254916, 0.47660306083262394, 0.4892632274240587, 0.5026551277479777, 0.5170784293767751, 0.5327592979710781, 0.5498218324550409, 0.5677021949950545, 0.5867128773258113, 0.6058434922392543, 0.6250745694297454, 0.6437922607194714, 0.6607521464509426, 0.6754521616016302, 0.6889058159197384, 0.7013639770266676, 0.7130337255710044, 0.7241369011437322, 0.7349218011172647, 0.7456508885055422, 0.7569356086117944, 0.7694823668182548, 0.7840386514201451, 0.802188253197531, 0.8267046718679647, 0.8526817858801529, 0.8729464004051749, 0.8893048193643267, 0.9034032904566678, 0.9158700059964637, 0.9271233527051129, 0.9374550277306558, 0.9470501448164161, 0.9560186102293311, 0.9644180705787866, 0.9722847997725862, 0.9819646863599553, 0.9912256118182045, 0.9998991417994532},
.param_9 = {1.1480916446373692, 0.5178107219340818, 0.495442041087906},
.param_10 = {80.39177130462943, 61.57183765254094, 62.709592948526534, 1328.2815300016448, 1182.0452233936048, 1110.8462065861343},
.param_11 = {0.6826503864970364, 0.3153331139876837, 0.21967384883923824, 0.5021514200556332, 0.2356223717935693, 0.15643189402753305},
.param_12 = {0.2701104280596505, 0.27025942820793075, 0.2710639665527944},
.name = {'L', 'P', '3', '0', '2', '5', '3', '5'},
