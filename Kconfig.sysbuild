## build/Kconfig/soc/Kconfig
```kconfig
# Load Zephyr SoC Kconfig descriptions.
osource "/Users/akw/Documents/GitHub/healthypi-move-workspace/zephyr/soc/xlnx/zynqmp/Kconfig"
osource "/Users/akw/Documents/GitHub/healthypi-move-workspace/zephyr/soc/xlnx/zynq7000/Kconfig"
osource "/Users/akw/Documents/GitHub/healthypi-move-workspace/zephyr/soc/xlnx/versalnet/Kconfig"
osource "/Users/akw/Documents/GitHub/healthypi-move-workspace/zephyr/soc/xlnx/versal2/Kconfig"
osource "/Users/akw/Documents/GitHub/healthypi-move-workspace/zephyr/soc/xen/Kconfig"
osource "/Users/akw/Documents/GitHub/healthypi-move-workspace/zephyr/soc/wch/ch32v/Kconfig"
osource "/Users/akw/Documents/GitHub/healthypi-move-workspace/zephyr/soc/ti/simplelink/Kconfig"
osource "/Users/akw/Documents/GitHub/healthypi-move-workspace/zephyr/soc/ti/mspm0/Kconfig"
osource "/Users/akw/Documents/GitHub/healthypi-move-workspace/zephyr/soc/ti/lm3s6965/Kconfig"
osource "/Users/akw/Documents/GitHub/healthypi-move-workspace/zephyr/soc/ti/k3/Kconfig"
osource "/Users/akw/Documents/GitHub/healthypi-move-workspace/zephyr/soc/telink/tlsr/Kconfig"
osource "/Users/akw/Documents/GitHub/healthypi-move-workspace/zephyr/soc/starfive/jh71xx/Kconfig"
osource "/Users/akw/Documents/GitHub/healthypi-move-workspace/zephyr/soc/st/stm32/Kconfig"
osource "/Users/akw/Documents/GitHub/healthypi-move-workspace/zephyr/soc/snps/qemu_arc/Kconfig"
osource "/Users/akw/Documents/GitHub/healthypi-move-workspace/zephyr/soc/snps/nsim/arc_v/Kconfig"
osource "/Users/akw/Documents/GitHub/healthypi-move-workspace/zephyr/soc/snps/nsim/arc_classic/Kconfig"
osource "/Users/akw/Documents/GitHub/healthypi-move-workspace/zephyr/soc/snps/hsdk4xd/Kconfig"
osource "/Users/akw/Documents/GitHub/healthypi-move-workspace/zephyr/soc/snps/hsdk/Kconfig"
osource "/Users/akw/Documents/GitHub/healthypi-move-workspace/zephyr/soc/snps/emsk/Kconfig"
osource "/Users/akw/Documents/GitHub/healthypi-move-workspace/zephyr/soc/snps/emsdp/Kconfig"
osource "/Users/akw/Documents/GitHub/healthypi-move-workspace/zephyr/soc/snps/arc_iot/Kconfig"
osource "/Users/akw/Documents/GitHub/healthypi-move-workspace/zephyr/soc/silabs/Kconfig"
osource "/Users/akw/Documents/GitHub/healthypi-move-workspace/zephyr/soc/sifive/sifive_freedom/Kconfig"
osource "/Users/akw/Documents/GitHub/healthypi-move-workspace/zephyr/soc/sensry/Kconfig"
osource "/Users/akw/Documents/GitHub/healthypi-move-workspace/zephyr/soc/rockchip/Kconfig"
osource "/Users/akw/Documents/GitHub/healthypi-move-workspace/zephyr/soc/renode/riscv_virtual/Kconfig"
osource "/Users/akw/Documents/GitHub/healthypi-move-workspace/zephyr/soc/renode/cortex_r8_virtual/Kconfig"
osource "/Users/akw/Documents/GitHub/healthypi-move-workspace/zephyr/soc/renesas/smartbond/Kconfig"
osource "/Users/akw/Documents/GitHub/healthypi-move-workspace/zephyr/soc/renesas/rz/Kconfig"
osource "/Users/akw/Documents/GitHub/healthypi-move-workspace/zephyr/soc/renesas/rx/Kconfig"
osource "/Users/akw/Documents/GitHub/healthypi-move-workspace/zephyr/soc/renesas/rcar/Kconfig"
osource "/Users/akw/Documents/GitHub/healthypi-move-workspace/zephyr/soc/renesas/ra/Kconfig"
osource "/Users/akw/Documents/GitHub/healthypi-move-workspace/zephyr/soc/realtek/ec/Kconfig"
osource "/Users/akw/Documents/GitHub/healthypi-move-workspace/zephyr/soc/raspberrypi/rpi_pico/Kconfig"
osource "/Users/akw/Documents/GitHub/healthypi-move-workspace/zephyr/soc/quicklogic/eos_s3/Kconfig"
osource "/Users/akw/Documents/GitHub/healthypi-move-workspace/zephyr/soc/qemu/virt_riscv/Kconfig"
osource "/Users/akw/Documents/GitHub/healthypi-move-workspace/zephyr/soc/qemu/malta/Kconfig"
osource "/Users/akw/Documents/GitHub/healthypi-move-workspace/zephyr/soc/openisa/rv32m1/Kconfig"
osource "/Users/akw/Documents/GitHub/healthypi-move-workspace/zephyr/soc/openhwgroup/cva6/Kconfig"
osource "/Users/akw/Documents/GitHub/healthypi-move-workspace/zephyr/soc/oct/osd32mp15x/Kconfig"
osource "/Users/akw/Documents/GitHub/healthypi-move-workspace/zephyr/soc/nxp/s32/Kconfig"
osource "/Users/akw/Documents/GitHub/healthypi-move-workspace/zephyr/soc/nxp/rw/Kconfig"
osource "/Users/akw/Documents/GitHub/healthypi-move-workspace/zephyr/soc/nxp/mcx/Kconfig"
osource "/Users/akw/Documents/GitHub/healthypi-move-workspace/zephyr/soc/nxp/lpc/Kconfig"
osource "/Users/akw/Documents/GitHub/healthypi-move-workspace/zephyr/soc/nxp/layerscape/Kconfig"
osource "/Users/akw/Documents/GitHub/healthypi-move-workspace/zephyr/soc/nxp/kinetis/Kconfig"
osource "/Users/akw/Documents/GitHub/healthypi-move-workspace/zephyr/soc/nxp/imxrt/Kconfig"
osource "/Users/akw/Documents/GitHub/healthypi-move-workspace/zephyr/soc/nxp/imx/Kconfig"
osource "/Users/akw/Documents/GitHub/healthypi-move-workspace/zephyr/soc/nuvoton/numicro/Kconfig"
osource "/Users/akw/Documents/GitHub/healthypi-move-workspace/zephyr/soc/nuvoton/numaker/Kconfig"
osource "/Users/akw/Documents/GitHub/healthypi-move-workspace/zephyr/soc/nuvoton/npcx/Kconfig"
osource "/Users/akw/Documents/GitHub/healthypi-move-workspace/zephyr/soc/nuvoton/npcm/Kconfig"
osource "/Users/akw/Documents/GitHub/healthypi-move-workspace/zephyr/soc/nordic/Kconfig"
osource "/Users/akw/Documents/GitHub/healthypi-move-workspace/zephyr/soc/neorv32/Kconfig"
osource "/Users/akw/Documents/GitHub/healthypi-move-workspace/zephyr/soc/native/inf_clock/Kconfig"
osource "/Users/akw/Documents/GitHub/healthypi-move-workspace/zephyr/soc/microchip/sam/Kconfig"
osource "/Users/akw/Documents/GitHub/healthypi-move-workspace/zephyr/soc/microchip/miv/Kconfig"
osource "/Users/akw/Documents/GitHub/healthypi-move-workspace/zephyr/soc/microchip/mec/Kconfig"
osource "/Users/akw/Documents/GitHub/healthypi-move-workspace/zephyr/soc/mediatek/mt8xxx/Kconfig"
osource "/Users/akw/Documents/GitHub/healthypi-move-workspace/zephyr/soc/lowrisc/opentitan/Kconfig"
osource "/Users/akw/Documents/GitHub/healthypi-move-workspace/zephyr/soc/litex/litex_vexriscv/Kconfig"
osource "/Users/akw/Documents/GitHub/healthypi-move-workspace/zephyr/soc/ite/ec/Kconfig"
osource "/Users/akw/Documents/GitHub/healthypi-move-workspace/zephyr/soc/intel/raptor_lake/Kconfig"
osource "/Users/akw/Documents/GitHub/healthypi-move-workspace/zephyr/soc/intel/lakemont/Kconfig"
osource "/Users/akw/Documents/GitHub/healthypi-move-workspace/zephyr/soc/intel/intel_socfpga_std/Kconfig"
osource "/Users/akw/Documents/GitHub/healthypi-move-workspace/zephyr/soc/intel/intel_socfpga/Kconfig"
osource "/Users/akw/Documents/GitHub/healthypi-move-workspace/zephyr/soc/intel/intel_niosv/Kconfig"
osource "/Users/akw/Documents/GitHub/healthypi-move-workspace/zephyr/soc/intel/intel_ish/Kconfig"
osource "/Users/akw/Documents/GitHub/healthypi-move-workspace/zephyr/soc/intel/intel_adsp/Kconfig"
osource "/Users/akw/Documents/GitHub/healthypi-move-workspace/zephyr/soc/intel/elkhart_lake/Kconfig"
osource "/Users/akw/Documents/GitHub/healthypi-move-workspace/zephyr/soc/intel/atom/Kconfig"
osource "/Users/akw/Documents/GitHub/healthypi-move-workspace/zephyr/soc/intel/apollo_lake/Kconfig"
osource "/Users/akw/Documents/GitHub/healthypi-move-workspace/zephyr/soc/intel/alder_lake/Kconfig"
osource "/Users/akw/Documents/GitHub/healthypi-move-workspace/zephyr/soc/infineon/cat3/Kconfig"
osource "/Users/akw/Documents/GitHub/healthypi-move-workspace/zephyr/soc/infineon/cat1c/Kconfig"
osource "/Users/akw/Documents/GitHub/healthypi-move-workspace/zephyr/soc/infineon/cat1b/Kconfig"
osource "/Users/akw/Documents/GitHub/healthypi-move-workspace/zephyr/soc/infineon/cat1a/Kconfig"
osource "/Users/akw/Documents/GitHub/healthypi-move-workspace/zephyr/soc/gd/gd32/Kconfig"
osource "/Users/akw/Documents/GitHub/healthypi-move-workspace/zephyr/soc/gaisler/leon3/Kconfig"
osource "/Users/akw/Documents/GitHub/healthypi-move-workspace/zephyr/soc/gaisler/gr716a/Kconfig"
osource "/Users/akw/Documents/GitHub/healthypi-move-workspace/zephyr/soc/espressif/Kconfig"
osource "/Users/akw/Documents/GitHub/healthypi-move-workspace/zephyr/soc/ene/kb1200/Kconfig"
osource "/Users/akw/Documents/GitHub/healthypi-move-workspace/zephyr/soc/efinix/sapphire/Kconfig"
osource "/Users/akw/Documents/GitHub/healthypi-move-workspace/zephyr/soc/cdns/xtensa_sample_controller/Kconfig"
osource "/Users/akw/Documents/GitHub/healthypi-move-workspace/zephyr/soc/cdns/sample_controller32/Kconfig"
osource "/Users/akw/Documents/GitHub/healthypi-move-workspace/zephyr/soc/cdns/dc233c/Kconfig"
osource "/Users/akw/Documents/GitHub/healthypi-move-workspace/zephyr/soc/brcm/bcmvk/Kconfig"
osource "/Users/akw/Documents/GitHub/healthypi-move-workspace/zephyr/soc/brcm/bcm2712/Kconfig"
osource "/Users/akw/Documents/GitHub/healthypi-move-workspace/zephyr/soc/brcm/bcm2711/Kconfig"
osource "/Users/akw/Documents/GitHub/healthypi-move-workspace/zephyr/soc/bflb/Kconfig"
osource "/Users/akw/Documents/GitHub/healthypi-move-workspace/zephyr/soc/atmel/sam0/Kconfig"
osource "/Users/akw/Documents/GitHub/healthypi-move-workspace/zephyr/soc/atmel/sam/Kconfig"
osource "/Users/akw/Documents/GitHub/healthypi-move-workspace/zephyr/soc/aspeed/Kconfig"
osource "/Users/akw/Documents/GitHub/healthypi-move-workspace/zephyr/soc/arm/Kconfig"
osource "/Users/akw/Documents/GitHub/healthypi-move-workspace/zephyr/soc/arm/beetle/Kconfig"
osource "/Users/akw/Documents/GitHub/healthypi-move-workspace/zephyr/soc/antmicro/myra/Kconfig"
osource "/Users/akw/Documents/GitHub/healthypi-move-workspace/zephyr/soc/andestech/Kconfig"
osource "/Users/akw/Documents/GitHub/healthypi-move-workspace/zephyr/soc/amd/acp_6_0/Kconfig"
osource "/Users/akw/Documents/GitHub/healthypi-move-workspace/zephyr/soc/ambiq/Kconfig"
osource "/Users/akw/Documents/GitHub/healthypi-move-workspace/zephyr/soc/aesc/Kconfig"
osource "/Users/akw/Documents/GitHub/healthypi-move-workspace/zephyr/soc/adi/max32/Kconfig"
osource "/Users/akw/Documents/GitHub/healthypi-move-workspace/nrf/soc/sercomm/nrf91/Kconfig"
osource "/Users/akw/Documents/GitHub/healthypi-move-workspace/nrf/soc/nordic/Kconfig"
```
