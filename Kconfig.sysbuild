## Kconfig.sysbuild
```kconfig
#
# Copyright (c) 2023 Nordic Semiconductor
#
# SPDX-License-Identifier: LicenseRef-Nordic-5-Clause
#

source "${ZEPHYR_BASE}/share/sysbuild/Kconfig"

config PM_EXTERNAL_FLASH_MCUBOOT_SECONDARY
	default y 

choice MCUBOOT_MODE
	default MCUBOOT_MODE_OVERWRITE_ONLY if SOC_SERIES_NRF53X
endchoice

config NRF_DEFAULT_IPC_RADIO
	default y

config NETCORE_IPC_RADIO_BT_HCI_IPC
	default y
```

## app/boards/protocentral/healthypi_move/board.yml
```yaml
board:
  name: healthypi_move
  vendor: protocentral
  socs:
  - name: 'nrf5340'
    variants:
    - name: 'ns'
      cpucluster: 'cpuapp'
```

## app/drivers/Kconfig
```kconfig
# SPDX-License-Identifier: Apache-2.0

menu "Drivers"
rsource "sensor/Kconfig"
rsource "display/Kconfig"
rsource "rtc/Kconfig"
rsource "input/Kconfig"
endmenu
```

## app/drivers/input/Kconfig
```kconfig
# Copyright 2023 Google LLC
# SPDX-License-Identifier: Apache-2.0

if INPUT

rsource "Kconfig.chsc5816"

endif # INPUT
```

## app/drivers/input/Kconfig.chsc5816
```kconfig
 # Copyright 2024 Protocentral Electronics
 # SPDX-License-Identifier: Apache-2.0
 # CHSC5816 Capacitive Touch Panel driver

config INPUT_CHSC5816
	bool "Use CHSC5816 capacitive touch panel driver"
	default y
	depends on DT_HAS_CHIPSEMI_CHSC5816_ENABLED
	select GPIO
	select I2C
	help
	  Enable out of tree driver for CHSC5816 touch panel.
```

## app/drivers/rtc/Kconfig
```kconfig
# Copyright (c) 2022 Bjarki Arge Andreasen
# SPDX-License-Identifier: Apache-2.0

rsource "Kconfig.rv8263"
```

## app/dts/bindings/input/chipsemi,chsc6x.yaml
```yaml
description: CHSC5816 touchscreen sensor

compatible: "chipsemi,chsc5816"

include: i2c-device.yaml

properties:
  irq-gpios:
    type: phandle-array
    required: true
    description: |
      Interrupt GPIO. Used by the controller to signal touch data is
      available. Active low.

  rst-gpios:
    type: phandle-array
    description: |
      The reset signal defaults to active low to the
      sensor. The property value should ensure the flags properly
      describe the signal that is presented to the driver.
```

## app/src/max32664_updater/Kconfig
```kconfig
# Configuration options

config MAX32664_UPDATER
	bool "MAX32664 Updater"
	default y
	select I2C
	help
		Enable the driver for the Maxim MAX32664 Updater

config MAX32664_UPDATER_MSBL
	bool "Enable MSBL support"
	default y
	depends on MAX32664_UPDATER
	help
		Enable support for the Maxim Serial Bootloader (MSBL) for the MAX32664 Updater

module = MAX32664_UPDATER
module-str = max32664_updater

source "subsys/logging/Kconfig.template.log_config"
```

## app/sysbuild/mcuboot/boards/healthypi_move_nrf5340_cpuapp.conf
```kconfig
# Configure MCUboot features
CONFIG_BOOT_MAX_IMG_SECTORS=256
CONFIG_MCUBOOT_DOWNGRADE_PREVENTION=y
CONFIG_BOOT_ECDSA_TINYCRYPT=y

# Enable flash simulator
CONFIG_PCD_APP=y
CONFIG_FLASH_SIMULATOR=y
CONFIG_FLASH_SIMULATOR_DOUBLE_WRITES=y
CONFIG_FLASH_SIMULATOR_STATS=n

CONFIG_NORDIC_QSPI_NOR=y
CONFIG_NORDIC_QSPI_NOR_FLASH_LAYOUT_PAGE_SIZE=4096

CONFIG_BOOT_IMAGE_ACCESS_HOOKS=y
CONFIG_BOOT_IMAGE_ACCESS_HOOK_NRF5340=y

CONFIG_MULTITHREADING=y
```

## boards/protocentral/healthypi_move/Kconfig
```kconfig
# nRF5340 DK board configuration

# Copyright (c) 2019 - 2021 Nordic Semiconductor ASA
# SPDX-License-Identifier: Apache-2.0

if BOARD_HEALTHYPI_MOVE_NRF5340_CPUAPP || BOARD_HEALTHYPI_MOVE_NRF5340_CPUAPP_NS

config DOMAIN_CPUNET_BOARD
	string
	default "healthypi_move/nrf5340/cpunet"
	depends on BOARD_ENABLE_CPUNET
	help
	  The board which will be used for CPUNET domain when creating a multi
	  image application where one or more images should be located on
	  another board. For example hci_rpmsg on the nRF5340_cpunet for
	  Bluetooth applications.

endif #  BOARD_HEALTHYPI_MOVE_NRF5340_CPUAPP || BOARD_HEALTHYPI_MOVE_NRF5340_CPUAPP_NS

config DOMAIN_CPUAPP_BOARD
	string
	default "healthypi_move/nrf5340/cpuapp"
	depends on BOARD_HEALTHYPI_MOVE_NRF5340_CPUNET
	help
	  The board which will be used for CPUAPP domain when creating a multi
	  image application where one or more images should be located on
	  another board.
```

## build/Kconfig/Kconfig.shield
```kconfig
osource "/Users/akw/Documents/GitHub/healthypi-move-workspace/healthypi-move-fw/app/boards/shields/*/Kconfig.shield"
osource "/Users/akw/Documents/GitHub/healthypi-move-workspace/healthypi-move-fw/boards/shields/*/Kconfig.shield"
osource "/Users/akw/Documents/GitHub/healthypi-move-workspace/nrf/boards/shields/*/Kconfig.shield"
```

## build/Kconfig/Kconfig.shield.defconfig
```kconfig
osource "/Users/akw/Documents/GitHub/healthypi-move-workspace/healthypi-move-fw/app/boards/shields/*/Kconfig.defconfig"
osource "/Users/akw/Documents/GitHub/healthypi-move-workspace/healthypi-move-fw/boards/shields/*/Kconfig.defconfig"
osource "/Users/akw/Documents/GitHub/healthypi-move-workspace/nrf/boards/shields/*/Kconfig.defconfig"
```

## build/Kconfig/arch/Kconfig
```kconfig
# Load Zephyr Arch Kconfig descriptions.
osource "/Users/akw/Documents/GitHub/healthypi-move-workspace/zephyr/arch/rx/Kconfig"
osource "/Users/akw/Documents/GitHub/healthypi-move-workspace/zephyr/arch/x86/Kconfig"
osource "/Users/akw/Documents/GitHub/healthypi-move-workspace/zephyr/arch/xtensa/Kconfig"
osource "/Users/akw/Documents/GitHub/healthypi-move-workspace/zephyr/arch/sparc/Kconfig"
osource "/Users/akw/Documents/GitHub/healthypi-move-workspace/zephyr/arch/riscv/Kconfig"
osource "/Users/akw/Documents/GitHub/healthypi-move-workspace/zephyr/arch/posix/Kconfig"
osource "/Users/akw/Documents/GitHub/healthypi-move-workspace/zephyr/arch/mips/Kconfig"
osource "/Users/akw/Documents/GitHub/healthypi-move-workspace/zephyr/arch/arm64/Kconfig"
osource "/Users/akw/Documents/GitHub/healthypi-move-workspace/zephyr/arch/arm/Kconfig"
osource "/Users/akw/Documents/GitHub/healthypi-move-workspace/zephyr/arch/arc/Kconfig"
```

## build/Kconfig/boards/Kconfig.defconfig
```kconfig
# Load Zephyr board defconfig descriptions.
osource "/Users/akw/Documents/GitHub/healthypi-move-workspace/healthypi-move-fw/boards/protocentral/healthypi_move/Kconfig.defconfig"
```

## build/Kconfig/boards/Kconfig.healthypi_move
```kconfig
# Load board Kconfig descriptions.
osource "/Users/akw/Documents/GitHub/healthypi-move-workspace/healthypi-move-fw/boards/protocentral/healthypi_move/Kconfig.healthypi_move"
```
