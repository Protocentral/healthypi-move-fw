## build/Kconfig/soc/Kconfig.soc
```kconfig
# Load SoC Kconfig descriptions.
osource "/Users/akw/Documents/GitHub/healthypi-move-workspace/zephyr/soc/xlnx/zynqmp/Kconfig.soc"
osource "/Users/akw/Documents/GitHub/healthypi-move-workspace/zephyr/soc/xlnx/zynq7000/Kconfig.soc"
osource "/Users/akw/Documents/GitHub/healthypi-move-workspace/zephyr/soc/xlnx/versalnet/Kconfig.soc"
osource "/Users/akw/Documents/GitHub/healthypi-move-workspace/zephyr/soc/xlnx/versal2/Kconfig.soc"
osource "/Users/akw/Documents/GitHub/healthypi-move-workspace/zephyr/soc/xen/Kconfig.soc"
osource "/Users/akw/Documents/GitHub/healthypi-move-workspace/zephyr/soc/wch/ch32v/Kconfig.soc"
osource "/Users/akw/Documents/GitHub/healthypi-move-workspace/zephyr/soc/ti/simplelink/Kconfig.soc"
osource "/Users/akw/Documents/GitHub/healthypi-move-workspace/zephyr/soc/ti/mspm0/Kconfig.soc"
osource "/Users/akw/Documents/GitHub/healthypi-move-workspace/zephyr/soc/ti/lm3s6965/Kconfig.soc"
osource "/Users/akw/Documents/GitHub/healthypi-move-workspace/zephyr/soc/ti/k3/Kconfig.soc"
osource "/Users/akw/Documents/GitHub/healthypi-move-workspace/zephyr/soc/telink/tlsr/Kconfig.soc"
osource "/Users/akw/Documents/GitHub/healthypi-move-workspace/zephyr/soc/starfive/jh71xx/Kconfig.soc"
osource "/Users/akw/Documents/GitHub/healthypi-move-workspace/zephyr/soc/st/stm32/Kconfig.soc"
osource "/Users/akw/Documents/GitHub/healthypi-move-workspace/zephyr/soc/snps/qemu_arc/Kconfig.soc"
osource "/Users/akw/Documents/GitHub/healthypi-move-workspace/zephyr/soc/snps/nsim/arc_v/Kconfig.soc"
osource "/Users/akw/Documents/GitHub/healthypi-move-workspace/zephyr/soc/snps/nsim/arc_classic/Kconfig.soc"
osource "/Users/akw/Documents/GitHub/healthypi-move-workspace/zephyr/soc/snps/hsdk4xd/Kconfig.soc"
osource "/Users/akw/Documents/GitHub/healthypi-move-workspace/zephyr/soc/snps/hsdk/Kconfig.soc"
osource "/Users/akw/Documents/GitHub/healthypi-move-workspace/zephyr/soc/snps/emsk/Kconfig.soc"
osource "/Users/akw/Documents/GitHub/healthypi-move-workspace/zephyr/soc/snps/emsdp/Kconfig.soc"
osource "/Users/akw/Documents/GitHub/healthypi-move-workspace/zephyr/soc/snps/arc_iot/Kconfig.soc"
osource "/Users/akw/Documents/GitHub/healthypi-move-workspace/zephyr/soc/silabs/Kconfig.soc"
osource "/Users/akw/Documents/GitHub/healthypi-move-workspace/zephyr/soc/sifive/sifive_freedom/Kconfig.soc"
osource "/Users/akw/Documents/GitHub/healthypi-move-workspace/zephyr/soc/sensry/Kconfig.soc"
osource "/Users/akw/Documents/GitHub/healthypi-move-workspace/zephyr/soc/rockchip/Kconfig.soc"
osource "/Users/akw/Documents/GitHub/healthypi-move-workspace/zephyr/soc/renode/riscv_virtual/Kconfig.soc"
osource "/Users/akw/Documents/GitHub/healthypi-move-workspace/zephyr/soc/renode/cortex_r8_virtual/Kconfig.soc"
osource "/Users/akw/Documents/GitHub/healthypi-move-workspace/zephyr/soc/renesas/smartbond/Kconfig.soc"
osource "/Users/akw/Documents/GitHub/healthypi-move-workspace/zephyr/soc/renesas/rz/Kconfig.soc"
osource "/Users/akw/Documents/GitHub/healthypi-move-workspace/zephyr/soc/renesas/rx/Kconfig.soc"
osource "/Users/akw/Documents/GitHub/healthypi-move-workspace/zephyr/soc/renesas/rcar/Kconfig.soc"
osource "/Users/akw/Documents/GitHub/healthypi-move-workspace/zephyr/soc/renesas/ra/Kconfig.soc"
osource "/Users/akw/Documents/GitHub/healthypi-move-workspace/zephyr/soc/realtek/ec/Kconfig.soc"
osource "/Users/akw/Documents/GitHub/healthypi-move-workspace/zephyr/soc/raspberrypi/rpi_pico/Kconfig.soc"
osource "/Users/akw/Documents/GitHub/healthypi-move-workspace/zephyr/soc/quicklogic/eos_s3/Kconfig.soc"
osource "/Users/akw/Documents/GitHub/healthypi-move-workspace/zephyr/soc/qemu/virt_riscv/Kconfig.soc"
osource "/Users/akw/Documents/GitHub/healthypi-move-workspace/zephyr/soc/qemu/malta/Kconfig.soc"
osource "/Users/akw/Documents/GitHub/healthypi-move-workspace/zephyr/soc/openisa/rv32m1/Kconfig.soc"
osource "/Users/akw/Documents/GitHub/healthypi-move-workspace/zephyr/soc/openhwgroup/cva6/Kconfig.soc"
osource "/Users/akw/Documents/GitHub/healthypi-move-workspace/zephyr/soc/oct/osd32mp15x/Kconfig.soc"
osource "/Users/akw/Documents/GitHub/healthypi-move-workspace/zephyr/soc/nxp/s32/Kconfig.soc"
osource "/Users/akw/Documents/GitHub/healthypi-move-workspace/zephyr/soc/nxp/rw/Kconfig.soc"
osource "/Users/akw/Documents/GitHub/healthypi-move-workspace/zephyr/soc/nxp/mcx/Kconfig.soc"
osource "/Users/akw/Documents/GitHub/healthypi-move-workspace/zephyr/soc/nxp/lpc/Kconfig.soc"
osource "/Users/akw/Documents/GitHub/healthypi-move-workspace/zephyr/soc/nxp/layerscape/Kconfig.soc"
osource "/Users/akw/Documents/GitHub/healthypi-move-workspace/zephyr/soc/nxp/kinetis/Kconfig.soc"
osource "/Users/akw/Documents/GitHub/healthypi-move-workspace/zephyr/soc/nxp/imxrt/Kconfig.soc"
osource "/Users/akw/Documents/GitHub/healthypi-move-workspace/zephyr/soc/nxp/imx/Kconfig.soc"
osource "/Users/akw/Documents/GitHub/healthypi-move-workspace/zephyr/soc/nuvoton/numicro/Kconfig.soc"
osource "/Users/akw/Documents/GitHub/healthypi-move-workspace/zephyr/soc/nuvoton/numaker/Kconfig.soc"
osource "/Users/akw/Documents/GitHub/healthypi-move-workspace/zephyr/soc/nuvoton/npcx/Kconfig.soc"
osource "/Users/akw/Documents/GitHub/healthypi-move-workspace/zephyr/soc/nuvoton/npcm/Kconfig.soc"
osource "/Users/akw/Documents/GitHub/healthypi-move-workspace/zephyr/soc/nordic/Kconfig.soc"
osource "/Users/akw/Documents/GitHub/healthypi-move-workspace/zephyr/soc/neorv32/Kconfig.soc"
osource "/Users/akw/Documents/GitHub/healthypi-move-workspace/zephyr/soc/native/inf_clock/Kconfig.soc"
osource "/Users/akw/Documents/GitHub/healthypi-move-workspace/zephyr/soc/microchip/sam/Kconfig.soc"
osource "/Users/akw/Documents/GitHub/healthypi-move-workspace/zephyr/soc/microchip/miv/Kconfig.soc"
osource "/Users/akw/Documents/GitHub/healthypi-move-workspace/zephyr/soc/microchip/mec/Kconfig.soc"
osource "/Users/akw/Documents/GitHub/healthypi-move-workspace/zephyr/soc/mediatek/mt8xxx/Kconfig.soc"
osource "/Users/akw/Documents/GitHub/healthypi-move-workspace/zephyr/soc/lowrisc/opentitan/Kconfig.soc"
osource "/Users/akw/Documents/GitHub/healthypi-move-workspace/zephyr/soc/litex/litex_vexriscv/Kconfig.soc"
osource "/Users/akw/Documents/GitHub/healthypi-move-workspace/zephyr/soc/ite/ec/Kconfig.soc"
osource "/Users/akw/Documents/GitHub/healthypi-move-workspace/zephyr/soc/intel/raptor_lake/Kconfig.soc"
osource "/Users/akw/Documents/GitHub/healthypi-move-workspace/zephyr/soc/intel/lakemont/Kconfig.soc"
osource "/Users/akw/Documents/GitHub/healthypi-move-workspace/zephyr/soc/intel/intel_socfpga_std/Kconfig.soc"
osource "/Users/akw/Documents/GitHub/healthypi-move-workspace/zephyr/soc/intel/intel_socfpga/Kconfig.soc"
osource "/Users/akw/Documents/GitHub/healthypi-move-workspace/zephyr/soc/intel/intel_niosv/Kconfig.soc"
osource "/Users/akw/Documents/GitHub/healthypi-move-workspace/zephyr/soc/intel/intel_ish/Kconfig.soc"
osource "/Users/akw/Documents/GitHub/healthypi-move-workspace/zephyr/soc/intel/intel_adsp/Kconfig.soc"
osource "/Users/akw/Documents/GitHub/healthypi-move-workspace/zephyr/soc/intel/elkhart_lake/Kconfig.soc"
osource "/Users/akw/Documents/GitHub/healthypi-move-workspace/zephyr/soc/intel/atom/Kconfig.soc"
osource "/Users/akw/Documents/GitHub/healthypi-move-workspace/zephyr/soc/intel/apollo_lake/Kconfig.soc"
osource "/Users/akw/Documents/GitHub/healthypi-move-workspace/zephyr/soc/intel/alder_lake/Kconfig.soc"
osource "/Users/akw/Documents/GitHub/healthypi-move-workspace/zephyr/soc/infineon/cat3/Kconfig.soc"
osource "/Users/akw/Documents/GitHub/healthypi-move-workspace/zephyr/soc/infineon/cat1c/Kconfig.soc"
osource "/Users/akw/Documents/GitHub/healthypi-move-workspace/zephyr/soc/infineon/cat1b/Kconfig.soc"
osource "/Users/akw/Documents/GitHub/healthypi-move-workspace/zephyr/soc/infineon/cat1a/Kconfig.soc"
osource "/Users/akw/Documents/GitHub/healthypi-move-workspace/zephyr/soc/gd/gd32/Kconfig.soc"
osource "/Users/akw/Documents/GitHub/healthypi-move-workspace/zephyr/soc/gaisler/leon3/Kconfig.soc"
osource "/Users/akw/Documents/GitHub/healthypi-move-workspace/zephyr/soc/gaisler/gr716a/Kconfig.soc"
osource "/Users/akw/Documents/GitHub/healthypi-move-workspace/zephyr/soc/espressif/Kconfig.soc"
osource "/Users/akw/Documents/GitHub/healthypi-move-workspace/zephyr/soc/ene/kb1200/Kconfig.soc"
osource "/Users/akw/Documents/GitHub/healthypi-move-workspace/zephyr/soc/efinix/sapphire/Kconfig.soc"
osource "/Users/akw/Documents/GitHub/healthypi-move-workspace/zephyr/soc/cdns/xtensa_sample_controller/Kconfig.soc"
osource "/Users/akw/Documents/GitHub/healthypi-move-workspace/zephyr/soc/cdns/sample_controller32/Kconfig.soc"
osource "/Users/akw/Documents/GitHub/healthypi-move-workspace/zephyr/soc/cdns/dc233c/Kconfig.soc"
osource "/Users/akw/Documents/GitHub/healthypi-move-workspace/zephyr/soc/brcm/bcmvk/Kconfig.soc"
osource "/Users/akw/Documents/GitHub/healthypi-move-workspace/zephyr/soc/brcm/bcm2712/Kconfig.soc"
osource "/Users/akw/Documents/GitHub/healthypi-move-workspace/zephyr/soc/brcm/bcm2711/Kconfig.soc"
osource "/Users/akw/Documents/GitHub/healthypi-move-workspace/zephyr/soc/bflb/Kconfig.soc"
osource "/Users/akw/Documents/GitHub/healthypi-move-workspace/zephyr/soc/atmel/sam0/Kconfig.soc"
osource "/Users/akw/Documents/GitHub/healthypi-move-workspace/zephyr/soc/atmel/sam/Kconfig.soc"
osource "/Users/akw/Documents/GitHub/healthypi-move-workspace/zephyr/soc/aspeed/Kconfig.soc"
osource "/Users/akw/Documents/GitHub/healthypi-move-workspace/zephyr/soc/arm/Kconfig.soc"
osource "/Users/akw/Documents/GitHub/healthypi-move-workspace/zephyr/soc/arm/beetle/Kconfig.soc"
osource "/Users/akw/Documents/GitHub/healthypi-move-workspace/zephyr/soc/antmicro/myra/Kconfig.soc"
osource "/Users/akw/Documents/GitHub/healthypi-move-workspace/zephyr/soc/andestech/Kconfig.soc"
osource "/Users/akw/Documents/GitHub/healthypi-move-workspace/zephyr/soc/amd/acp_6_0/Kconfig.soc"
osource "/Users/akw/Documents/GitHub/healthypi-move-workspace/zephyr/soc/ambiq/Kconfig.soc"
osource "/Users/akw/Documents/GitHub/healthypi-move-workspace/zephyr/soc/aesc/Kconfig.soc"
osource "/Users/akw/Documents/GitHub/healthypi-move-workspace/zephyr/soc/adi/max32/Kconfig.soc"
osource "/Users/akw/Documents/GitHub/healthypi-move-workspace/nrf/soc/sercomm/nrf91/Kconfig.soc"
osource "/Users/akw/Documents/GitHub/healthypi-move-workspace/nrf/soc/nordic/Kconfig.soc"
```

## drivers/display/Kconfig
```kconfig
menuconfig DISPLAY
	bool "Display Drivers"
	help
	  Enable display drivers

if DISPLAY

config DISPLAY_INIT_PRIORITY
	int "Display devices init priority"
	default 85
	help
	  Display devices initialization priority.

module = DISPLAY
module-str = display

source "subsys/logging/Kconfig.template.log_config"

rsource "Kconfig.gc9a01a"
rsource "Kconfig.sh8601"

endif
```

## drivers/display/Kconfig.sh8601a
```kconfig
# SH8601A display driver configuration options

# SPDX-License-Identifier: Apache-2.0

config SH8601A
	bool "SH8601A display driver"
	default y
	depends on DT_HAS_SHENGETECH_SH8601A_ENABLED
	select SPI
	help
	  Enable driver for SH8601A display driver.
```

## drivers/input/Kconfig.chsc5816
```kconfig
# Copyright (c) 2024 Nicolas Goualard <nicolas.goualard@sfr.fr>
# SPDX-License-Identifier: Apache-2.0

config INPUT_CHSC5816
	bool "Use CHSC5816 capacitive touch panel driver"
	default y
	depends on DT_HAS_CHIPSEMI_CHSC5816_ENABLED
	select GPIO
	select I2C
	help
	  Enable out of tree driver for CHSC5816 touch panel.
```

## drivers/rtc/Kconfig.rv8263
```kconfig
# Copyright (c) 2022 Brian Bradley
# SPDX-License-Identifier: Apache-2.0

config RTC_RV8263
	bool "Microcrystal RV8263 RTC"
	select I2C
	help
	  Enable driver for a Micro Crystal rtc time api
```

## drivers/sensor/Kconfig
```kconfig
# SPDX-License-Identifier: Apache-2.0

rsource "max30001/Kconfig"
rsource "max32664c/Kconfig"
rsource "max32664d/Kconfig"
rsource "maxm86146/Kconfig"
rsource "max30208/Kconfig"
rsource "bmi323hpi/Kconfig"
rsource "ams_as6221/Kconfig"
```

## drivers/sensor/ams_as6221/Kconfig
```kconfig
# SPDX-License-Identifier: Apache-2.0

config AMS_AS6221
	bool "AMS AS6221 digital temperature sensor"
	default y
	depends on DT_HAS_AMS_AS6221_ENABLED
	depends on I2C
	help
	  Enable driver for the AMS AS6221 digital temperature sensor.
	  16-bit resolution (0.0078125 C/LSB), I2C interface.
```
