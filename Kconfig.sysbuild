## build/Kconfig/soc/Kconfig.defconfig
```kconfig
# Load Zephyr SoC defconfig descriptions.
osource "/Users/akw/Documents/GitHub/healthypi-move-workspace/zephyr/soc/xlnx/zynqmp/Kconfig.defconfig"
osource "/Users/akw/Documents/GitHub/healthypi-move-workspace/zephyr/soc/xlnx/zynq7000/Kconfig.defconfig"
osource "/Users/akw/Documents/GitHub/healthypi-move-workspace/zephyr/soc/xlnx/versalnet/Kconfig.defconfig"
osource "/Users/akw/Documents/GitHub/healthypi-move-workspace/zephyr/soc/xlnx/versal2/Kconfig.defconfig"
osource "/Users/akw/Documents/GitHub/healthypi-move-workspace/zephyr/soc/xen/Kconfig.defconfig"
osource "/Users/akw/Documents/GitHub/healthypi-move-workspace/zephyr/soc/wch/ch32v/Kconfig.defconfig"
osource "/Users/akw/Documents/GitHub/healthypi-move-workspace/zephyr/soc/ti/simplelink/Kconfig.defconfig"
osource "/Users/akw/Documents/GitHub/healthypi-move-workspace/zephyr/soc/ti/mspm0/Kconfig.defconfig"
osource "/Users/akw/Documents/GitHub/healthypi-move-workspace/zephyr/soc/ti/lm3s6965/Kconfig.defconfig"
osource "/Users/akw/Documents/GitHub/healthypi-move-workspace/zephyr/soc/ti/k3/Kconfig.defconfig"
osource "/Users/akw/Documents/GitHub/healthypi-move-workspace/zephyr/soc/telink/tlsr/Kconfig.defconfig"
osource "/Users/akw/Documents/GitHub/healthypi-move-workspace/zephyr/soc/starfive/jh71xx/Kconfig.defconfig"
osource "/Users/akw/Documents/GitHub/healthypi-move-workspace/zephyr/soc/st/stm32/Kconfig.defconfig"
osource "/Users/akw/Documents/GitHub/healthypi-move-workspace/zephyr/soc/snps/qemu_arc/Kconfig.defconfig"
osource "/Users/akw/Documents/GitHub/healthypi-move-workspace/zephyr/soc/snps/nsim/arc_v/Kconfig.defconfig"
osource "/Users/akw/Documents/GitHub/healthypi-move-workspace/zephyr/soc/snps/nsim/arc_classic/Kconfig.defconfig"
osource "/Users/akw/Documents/GitHub/healthypi-move-workspace/zephyr/soc/snps/hsdk4xd/Kconfig.defconfig"
osource "/Users/akw/Documents/GitHub/healthypi-move-workspace/zephyr/soc/snps/hsdk/Kconfig.defconfig"
osource "/Users/akw/Documents/GitHub/healthypi-move-workspace/zephyr/soc/snps/emsk/Kconfig.defconfig"
osource "/Users/akw/Documents/GitHub/healthypi-move-workspace/zephyr/soc/snps/emsdp/Kconfig.defconfig"
osource "/Users/akw/Documents/GitHub/healthypi-move-workspace/zephyr/soc/snps/arc_iot/Kconfig.defconfig"
osource "/Users/akw/Documents/GitHub/healthypi-move-workspace/zephyr/soc/silabs/Kconfig.defconfig"
osource "/Users/akw/Documents/GitHub/healthypi-move-workspace/zephyr/soc/sifive/sifive_freedom/Kconfig.defconfig"
osource "/Users/akw/Documents/GitHub/healthypi-move-workspace/zephyr/soc/sensry/Kconfig.defconfig"
osource "/Users/akw/Documents/GitHub/healthypi-move-workspace/zephyr/soc/rockchip/Kconfig.defconfig"
osource "/Users/akw/Documents/GitHub/healthypi-move-workspace/zephyr/soc/renode/riscv_virtual/Kconfig.defconfig"
osource "/Users/akw/Documents/GitHub/healthypi-move-workspace/zephyr/soc/renode/cortex_r8_virtual/Kconfig.defconfig"
osource "/Users/akw/Documents/GitHub/healthypi-move-workspace/zephyr/soc/renesas/smartbond/Kconfig.defconfig"
osource "/Users/akw/Documents/GitHub/healthypi-move-workspace/zephyr/soc/renesas/rz/Kconfig.defconfig"
osource "/Users/akw/Documents/GitHub/healthypi-move-workspace/zephyr/soc/renesas/rx/Kconfig.defconfig"
osource "/Users/akw/Documents/GitHub/healthypi-move-workspace/zephyr/soc/renesas/rcar/Kconfig.defconfig"
osource "/Users/akw/Documents/GitHub/healthypi-move-workspace/zephyr/soc/renesas/ra/Kconfig.defconfig"
osource "/Users/akw/Documents/GitHub/healthypi-move-workspace/zephyr/soc/realtek/ec/Kconfig.defconfig"
osource "/Users/akw/Documents/GitHub/healthypi-move-workspace/zephyr/soc/raspberrypi/rpi_pico/Kconfig.defconfig"
osource "/Users/akw/Documents/GitHub/healthypi-move-workspace/zephyr/soc/quicklogic/eos_s3/Kconfig.defconfig"
osource "/Users/akw/Documents/GitHub/healthypi-move-workspace/zephyr/soc/qemu/virt_riscv/Kconfig.defconfig"
osource "/Users/akw/Documents/GitHub/healthypi-move-workspace/zephyr/soc/qemu/malta/Kconfig.defconfig"
osource "/Users/akw/Documents/GitHub/healthypi-move-workspace/zephyr/soc/openisa/rv32m1/Kconfig.defconfig"
osource "/Users/akw/Documents/GitHub/healthypi-move-workspace/zephyr/soc/openhwgroup/cva6/Kconfig.defconfig"
osource "/Users/akw/Documents/GitHub/healthypi-move-workspace/zephyr/soc/oct/osd32mp15x/Kconfig.defconfig"
osource "/Users/akw/Documents/GitHub/healthypi-move-workspace/zephyr/soc/nxp/s32/Kconfig.defconfig"
osource "/Users/akw/Documents/GitHub/healthypi-move-workspace/zephyr/soc/nxp/rw/Kconfig.defconfig"
osource "/Users/akw/Documents/GitHub/healthypi-move-workspace/zephyr/soc/nxp/mcx/Kconfig.defconfig"
osource "/Users/akw/Documents/GitHub/healthypi-move-workspace/zephyr/soc/nxp/lpc/Kconfig.defconfig"
osource "/Users/akw/Documents/GitHub/healthypi-move-workspace/zephyr/soc/nxp/layerscape/Kconfig.defconfig"
osource "/Users/akw/Documents/GitHub/healthypi-move-workspace/zephyr/soc/nxp/kinetis/Kconfig.defconfig"
osource "/Users/akw/Documents/GitHub/healthypi-move-workspace/zephyr/soc/nxp/imxrt/Kconfig.defconfig"
osource "/Users/akw/Documents/GitHub/healthypi-move-workspace/zephyr/soc/nxp/imx/Kconfig.defconfig"
osource "/Users/akw/Documents/GitHub/healthypi-move-workspace/zephyr/soc/nuvoton/numicro/Kconfig.defconfig"
osource "/Users/akw/Documents/GitHub/healthypi-move-workspace/zephyr/soc/nuvoton/numaker/Kconfig.defconfig"
osource "/Users/akw/Documents/GitHub/healthypi-move-workspace/zephyr/soc/nuvoton/npcx/Kconfig.defconfig"
osource "/Users/akw/Documents/GitHub/healthypi-move-workspace/zephyr/soc/nuvoton/npcm/Kconfig.defconfig"
osource "/Users/akw/Documents/GitHub/healthypi-move-workspace/zephyr/soc/nordic/Kconfig.defconfig"
osource "/Users/akw/Documents/GitHub/healthypi-move-workspace/zephyr/soc/neorv32/Kconfig.defconfig"
osource "/Users/akw/Documents/GitHub/healthypi-move-workspace/zephyr/soc/native/inf_clock/Kconfig.defconfig"
osource "/Users/akw/Documents/GitHub/healthypi-move-workspace/zephyr/soc/microchip/sam/Kconfig.defconfig"
osource "/Users/akw/Documents/GitHub/healthypi-move-workspace/zephyr/soc/microchip/miv/Kconfig.defconfig"
osource "/Users/akw/Documents/GitHub/healthypi-move-workspace/zephyr/soc/microchip/mec/Kconfig.defconfig"
osource "/Users/akw/Documents/GitHub/healthypi-move-workspace/zephyr/soc/mediatek/mt8xxx/Kconfig.defconfig"
osource "/Users/akw/Documents/GitHub/healthypi-move-workspace/zephyr/soc/lowrisc/opentitan/Kconfig.defconfig"
osource "/Users/akw/Documents/GitHub/healthypi-move-workspace/zephyr/soc/litex/litex_vexriscv/Kconfig.defconfig"
osource "/Users/akw/Documents/GitHub/healthypi-move-workspace/zephyr/soc/ite/ec/Kconfig.defconfig"
osource "/Users/akw/Documents/GitHub/healthypi-move-workspace/zephyr/soc/intel/raptor_lake/Kconfig.defconfig"
osource "/Users/akw/Documents/GitHub/healthypi-move-workspace/zephyr/soc/intel/lakemont/Kconfig.defconfig"
osource "/Users/akw/Documents/GitHub/healthypi-move-workspace/zephyr/soc/intel/intel_socfpga_std/Kconfig.defconfig"
osource "/Users/akw/Documents/GitHub/healthypi-move-workspace/zephyr/soc/intel/intel_socfpga/Kconfig.defconfig"
osource "/Users/akw/Documents/GitHub/healthypi-move-workspace/zephyr/soc/intel/intel_niosv/Kconfig.defconfig"
osource "/Users/akw/Documents/GitHub/healthypi-move-workspace/zephyr/soc/intel/intel_ish/Kconfig.defconfig"
osource "/Users/akw/Documents/GitHub/healthypi-move-workspace/zephyr/soc/intel/intel_adsp/Kconfig.defconfig"
osource "/Users/akw/Documents/GitHub/healthypi-move-workspace/zephyr/soc/intel/elkhart_lake/Kconfig.defconfig"
osource "/Users/akw/Documents/GitHub/healthypi-move-workspace/zephyr/soc/intel/atom/Kconfig.defconfig"
osource "/Users/akw/Documents/GitHub/healthypi-move-workspace/zephyr/soc/intel/apollo_lake/Kconfig.defconfig"
osource "/Users/akw/Documents/GitHub/healthypi-move-workspace/zephyr/soc/intel/alder_lake/Kconfig.defconfig"
osource "/Users/akw/Documents/GitHub/healthypi-move-workspace/zephyr/soc/infineon/cat3/Kconfig.defconfig"
osource "/Users/akw/Documents/GitHub/healthypi-move-workspace/zephyr/soc/infineon/cat1c/Kconfig.defconfig"
osource "/Users/akw/Documents/GitHub/healthypi-move-workspace/zephyr/soc/infineon/cat1b/Kconfig.defconfig"
osource "/Users/akw/Documents/GitHub/healthypi-move-workspace/zephyr/soc/infineon/cat1a/Kconfig.defconfig"
osource "/Users/akw/Documents/GitHub/healthypi-move-workspace/zephyr/soc/gd/gd32/Kconfig.defconfig"
osource "/Users/akw/Documents/GitHub/healthypi-move-workspace/zephyr/soc/gaisler/leon3/Kconfig.defconfig"
osource "/Users/akw/Documents/GitHub/healthypi-move-workspace/zephyr/soc/gaisler/gr716a/Kconfig.defconfig"
osource "/Users/akw/Documents/GitHub/healthypi-move-workspace/zephyr/soc/espressif/Kconfig.defconfig"
osource "/Users/akw/Documents/GitHub/healthypi-move-workspace/zephyr/soc/ene/kb1200/Kconfig.defconfig"
osource "/Users/akw/Documents/GitHub/healthypi-move-workspace/zephyr/soc/efinix/sapphire/Kconfig.defconfig"
osource "/Users/akw/Documents/GitHub/healthypi-move-workspace/zephyr/soc/cdns/xtensa_sample_controller/Kconfig.defconfig"
osource "/Users/akw/Documents/GitHub/healthypi-move-workspace/zephyr/soc/cdns/sample_controller32/Kconfig.defconfig"
osource "/Users/akw/Documents/GitHub/healthypi-move-workspace/zephyr/soc/cdns/dc233c/Kconfig.defconfig"
osource "/Users/akw/Documents/GitHub/healthypi-move-workspace/zephyr/soc/brcm/bcmvk/Kconfig.defconfig"
osource "/Users/akw/Documents/GitHub/healthypi-move-workspace/zephyr/soc/brcm/bcm2712/Kconfig.defconfig"
osource "/Users/akw/Documents/GitHub/healthypi-move-workspace/zephyr/soc/brcm/bcm2711/Kconfig.defconfig"
osource "/Users/akw/Documents/GitHub/healthypi-move-workspace/zephyr/soc/bflb/Kconfig.defconfig"
osource "/Users/akw/Documents/GitHub/healthypi-move-workspace/zephyr/soc/atmel/sam0/Kconfig.defconfig"
osource "/Users/akw/Documents/GitHub/healthypi-move-workspace/zephyr/soc/atmel/sam/Kconfig.defconfig"
osource "/Users/akw/Documents/GitHub/healthypi-move-workspace/zephyr/soc/aspeed/Kconfig.defconfig"
osource "/Users/akw/Documents/GitHub/healthypi-move-workspace/zephyr/soc/arm/Kconfig.defconfig"
osource "/Users/akw/Documents/GitHub/healthypi-move-workspace/zephyr/soc/arm/beetle/Kconfig.defconfig"
osource "/Users/akw/Documents/GitHub/healthypi-move-workspace/zephyr/soc/antmicro/myra/Kconfig.defconfig"
osource "/Users/akw/Documents/GitHub/healthypi-move-workspace/zephyr/soc/andestech/Kconfig.defconfig"
osource "/Users/akw/Documents/GitHub/healthypi-move-workspace/zephyr/soc/amd/acp_6_0/Kconfig.defconfig"
osource "/Users/akw/Documents/GitHub/healthypi-move-workspace/zephyr/soc/ambiq/Kconfig.defconfig"
osource "/Users/akw/Documents/GitHub/healthypi-move-workspace/zephyr/soc/aesc/Kconfig.defconfig"
osource "/Users/akw/Documents/GitHub/healthypi-move-workspace/zephyr/soc/adi/max32/Kconfig.defconfig"
osource "/Users/akw/Documents/GitHub/healthypi-move-workspace/nrf/soc/sercomm/nrf91/Kconfig.defconfig"
osource "/Users/akw/Documents/GitHub/healthypi-move-workspace/nrf/soc/nordic/Kconfig.defconfig"
```
