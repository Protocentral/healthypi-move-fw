## app/tests/hs_hrv/testcase.yaml
```yaml
tests:
  healthypi.hs.hrv:
    tags: health_store hrv
    platform_allow:
      - qemu_cortex_m3
      - native_sim
    integration_platforms:
      - qemu_cortex_m3
```

## app/tests/hs_hrv_correct/testcase.yaml
```yaml
tests:
  healthypi.hs.hrv.correct:
    tags: health_store hrv_correct
    platform_allow:
      - qemu_cortex_m3
      - native_sim
    integration_platforms:
      - qemu_cortex_m3
```

## app/tests/hs_hrv_pool/testcase.yaml
```yaml
tests:
  healthypi.hs.hrv.pool:
    tags: health_store hrv_pool
    platform_allow:
      - qemu_cortex_m3
      - native_sim
    integration_platforms:
      - qemu_cortex_m3
```

## app/tests/hs_readiness/testcase.yaml
```yaml
tests:
  healthypi.hs.readiness:
    tags: health_store readiness
    platform_allow:
      - qemu_cortex_m3
      - native_sim
    integration_platforms:
      - qemu_cortex_m3
```

## app/tests/hs_stress/testcase.yaml
```yaml
tests:
  healthypi.hs.stress:
    tags: health_store stress
    platform_allow:
      - qemu_cortex_m3
      - native_sim
    integration_platforms:
      - qemu_cortex_m3
```

## boards/protocentral/healthypi_move/board.yml
```yaml
board:
  name: healthypi_move
  full_name: HealthyPi Move
  vendor: protocentral
  socs:
  - name: 'nrf5340'
    variants:
    - name: 'ns'
      cpucluster: 'cpuapp'
```

## drivers/input/Kconfig
```kconfig
# Copyright 2023 Google LLC
# SPDX-License-Identifier: Apache-2.0

if INPUT

rsource "Kconfig.chsc5816"
rsource "Kconfig.cst816s"

endif # INPUT
```

## drivers/input/Kconfig.cst816s
```kconfig
config INPUT_CST816S
	bool "Use CST816S capacitive touch panel driver"
	default y
	depends on DT_HAS_HYNITRON_CST816S_ENABLED
	select GPIO
	select I2C
	help
	  Enable out of tree driver for CST816S touch panel.
```

## drivers/sensor/as6221/Kconfig
```kconfig
# ProtoCentral Electronics (info@protocentral.com)
# SPDX-License-Identifier: Apache-2.0

config SENSOR_AS6221
	bool "AS6221 Temperature Sensor"
	depends on I2C
	help
	  Enable driver for the ams AS6221 digital temperature sensor.
	  Used on newer HealthyPi Move boards in place of the MAX30208.
```

## drivers/sensor/max30001/Kconfig
```kconfig
# Configuration options

config SENSOR_MAX30001
	bool "MAX30001 Driver"
	default y
	select SPI
	help
	  Enable the driver for the Maxim MAX30001 ECG and Bioimpedance

if SENSOR_MAX30001

config SENSOR_MAX30001_INIT_PRIORITY
	int "Init priority"
	default 80
	help
	  MAX30001 device driver initialization priority.

config MAX30001_TRIGGER
	bool "DRDY (INTB) interrupt-driven acquisition"
	default n
	depends on GPIO
	help
	  Drive ECG/BioZ FIFO reads from the MAX30001 INTB (DRDY) interrupt
	  instead of the application's polling timers (P3 interrupt/RTIO).
	  Requires the `intb-gpios` property on the max30001 DT node (routed to
	  nRF5340 P1.09 on HealthyPi Move). The driver enables EINT/BINT on the
	  INTB pin and invokes an application-registered handler on assertion;
	  the app then performs the same RTIO sensor_read it does today.

	  HARDWARE-GATED: verify sample rates on a scope before enabling in a
	  production build. Left OFF, acquisition stays on the proven poll path.

endif # SENSOR_MAX30001

module = MAX30001
module-str = max30001

source "subsys/logging/Kconfig.template.log_config"
```

## drivers/sensor/max30208/Kconfig
```kconfig
# ProtoCentral Electronics (info@protocentral.com)
# SPDX-License-Identifier: Apache-2.0

config SENSOR_MAX30208
	bool "MAX30208 Temperature Sensor"
	default y
	depends on DT_HAS_MAXIM_MAX30208_ENABLED
	select I2C
```

## drivers/sensor/max32664d/Kconfig
```kconfig
# Configuration options

config SENSOR_MAX32664D
	bool "MAX32664D Driver"
	default y
	depends on DT_HAS_MAXIM_MAX32664_ENABLED
	select I2C
	help
		Enable the driver for the Maxim MAX32664D sensor

module = MAX32664D
module-str = max32664d

source "subsys/logging/Kconfig.template.log_config"
```

## dts/bindings/ams,as6221.yaml
```yaml
# Ashwin Whitchurch
# ProtoCentral Electronics (info@protocentral.com)
# SPDX-License-Identifier: Apache-2.0

description: ams AS6221 digital temperature sensor

compatible: "ams,as6221"

include: [sensor-device.yaml, i2c-device.yaml]
```

## dts/bindings/input/hynitron,cst816s.yaml
```yaml
description: CST816S touchscreen sensor

compatible: "hynitron,cst816s"

include: i2c-device.yaml

properties:
  irq-gpios:
    type: phandle-array
    required: true
    description: |
      Interrupt GPIO. Used by the controller to signal touch data is
      available. Active low.

  reset-gpios:
    type: phandle-array
    description: |
      The reset signal defaults to active low to the
      sensor. The property value should ensure the flags properly
      describe the signal that is presented to the driver.
```

## west.yml
```yaml
manifest:
  self:
    west-commands: scripts/west-commands.yml

  remotes:
    - name: zephyrproject-rtos
      url-base: https://github.com/zephyrproject-rtos
    - name: protocentral
      url-base: https://github.com/Protocentral

  projects:
    - name: zephyr
      remote: zephyrproject-rtos
      revision: v4.4.2
      import:
        name-allowlist:
          - cmsis
          - cmsis_6
          - cmsis-dsp
          - fatfs
          - hal_nordic
          - libmetal
          - littlefs
          - lvgl
          - mbedtls
          - mcuboot
          - open-amp
          - picolibc
          - segger
          - tf-psa-crypto
          - zcbor
      clone-depth: 1

#    - name: max30001
#      repo-path: protocentral_max30001_zephyr_driver
#      remote: protocentral
#      revision: main
#      path: drivers/sensor/max30001
```
