## drivers/sensor/bmi323_hpi/Kconfig
```kconfig
# Copyright (c) 2023 Trackunit Corporation
# SPDX-License-Identifier: Apache-2.0

menuconfig BMI323_HPI
	bool "BMI323 measurement unit"
	default y
	select I2C
	depends on DT_HAS_BOSCH_BMI323_HPI_ENABLED
	help
	  Enable driver for BMI323 IMU sensor.
	  The driver implements the following features:

	  * Enable and disable accelerometer and gyroscope respectively
	  * Set full scale for accelerometer and gyroscope respectively
	  * Set data rate for accelerometer and gyroscope respectively
	  * Get samples (x,y,z) from accelerometer and gyroscope respectively
	  * Get die temperature
	  * Set trigger to accelerometer data ready, and accelerometer any motion.

	  The driver implements device and device runtime power management. If
	  runtime management is used, it is initialized into the suspended state,
	  which soft-resets the device to achieve the lowest possible power
	  consumption, otherwise it is resumed when initialized. When resumed,
	  the bus is initialized, the feature engine is enabled, and INT1 is
	  initialized.

	  The driver only implements the SPI bus at this time. The driver is
	  prepared to be expanded with I2C support in the future.
```

## drivers/sensor/max32664/Kconfig
```kconfig
# Configuration options

config SENSOR_MAX32664
	bool "MAX32664 Driver"
	default y
	select I2C
	help
		Enable the driver for the Maxim MAX32664 sensor
```

## drivers/sensor/maxm86146/Kconfig
```kconfig
# Configuration options for MAXM86146 driver

config SENSOR_MAXM86146
	bool "MAXM86146 Integrated Optical Biosensing Module Driver"
	default y
	select I2C
	help
		Enable the driver for the Maxim MAXM86146 integrated optical
		biosensing module. This module contains an integrated AFE and
		uses the MAX32664 sensor hub protocol.

module = MAXM86146
module-str = maxm86146

source "subsys/logging/Kconfig.template.log_config"
```

## dts/bindings/display/sitronix,sh8601.yaml
```yaml
#
# Copyright 2024 Protocentral Electronics
# 
# SPDX-License-Identifier: Apache-2.0
# 
# SH8601 AMOLED display driver.
#


description: SH8601 480x480 circular display controller

compatible: "sitronix,sh8601"

include: [mipi-dbi-spi-device.yaml, display-controller.yaml]

properties:
    pixel-format:
      type: int
      default: 1
      enum:
        - 0 # RGB565
        - 1 # RGB888
      description:
        Display pixel format. 
    rotation:
      type: int
      default: 0
      enum:
        - 0
        - 90
        - 180
        - 270
      description:
        Display rotation (CW) in degrees.
    
    display-inversion:
      type: boolean
      description:
        Display inversion mode. Every bit is inverted from the frame memory to
        the display.
```

## dts/bindings/maxim,max30208.yaml
```yaml
# Ashwin Whitchurch
# ProtoCentral Electronics (info@protocentral.com)
# SPDX-License-Identifier: Apache-2.0

description: Zephyr driver for the MAX30208 Temperature Sensor

compatible: "maxim,max30208"

include: [sensor-device.yaml, i2c-device.yaml]

properties:
    gpio0-gpios:
        type: phandle-array
        required: false
        description: |
            Phandle-array to the MCU GPIO connected to MAX30208 GPIO0. Used for
            input/interrupt or output control.

    gpio0-mode:
        type: int
        required: false
        description: |
            Two-bit mode value for GPIO0 to be written to GPIO_SETUP register.
            0: HiZ input
            1: Open-drain output
            2: Input with 1MΩ pulldown (default)
            3: Interrupt

    gpio1-gpios:
        type: phandle-array
        required: false
        description: |
            Phandle-array to the MCU GPIO connected to MAX30208 GPIO1. Used for
            input/convert-trigger or output control.

    gpio1-mode:
        type: int
        required: false
        description: |
            Two-bit mode value for GPIO1 to be written to GPIO_SETUP register.
            0: HiZ input
            1: Open-drain output
            2: Input with 1MΩ pulldown (default)
            3: Convert trigger
```

## dts/bindings/maxim,maxm86146.yaml
```yaml
# ProtoCentral Electronics (info@protocentral.com)
# SPDX-License-Identifier: Apache-2.0

description: MAXM86146 I2C Device

compatible: "maxim,maxm86146"

include: [sensor-device.yaml, i2c-device.yaml]

properties:
    reset-gpios:
      type: phandle-array
      required: true
      description: RESET pin.

        The RESET pin of MAXM86146 is active low.
        If connected directly the MCU pin should be configured
        as active low.

    mfio-gpios:
      type: phandle-array
      required: true
      description: MFIO pin.

        Pin for MFIO control.
```

## dts/bindings/ti,afe4400.yaml
```yaml
# ProtoCentral Electronics (info@protocentral.com)
# SPDX-License-Identifier: Apache-2.0

description: AFE4400 SPI Device

compatible: "ti,afe4400"

include: [sensor-device.yaml, spi-device.yaml]

properties:
  pwdn-gpios:
    type: phandle-array
    description: |
      Powerdown pin required
```

## healthypi-move-fw/boards/protocentral/healthypi_move/Kconfig.healthypi_move
```kconfig
# nRF5340 DK NRF5340 board configuration

# Copyright (c) 2019-2020 Nordic Semiconductor ASA
# SPDX-License-Identifier: Apache-2.0

config BOARD_HEALTHYPI_MOVE
	select SOC_NRF5340_CPUAPP_QKAA if BOARD_HEALTHYPI_MOVE_NRF5340_CPUAPP
	select SOC_NRF5340_CPUAPP_QKAA if BOARD_HEALTHYPI_MOVE_NRF5340_CPUAPP_NS
	select SOC_NRF5340_CPUNET_QKAA if BOARD_HEALTHYPI_MOVE_NRF5340_CPUNET
```

## healthypi-move-fw/drivers/display/Kconfig.sh8601
```kconfig
# SH8601 display driver configuration options

# SPDX-License-Identifier: Apache-2.0

config SH8601
	bool "SH8601 display driver"
	default y
	depends on DT_HAS_SITRONIX_SH8601_ENABLED
	select SPI
	help
	  Enable driver for SH8601 display driver.
```

## healthypi-move-fw/drivers/sensor/bmi323hpi/Kconfig
```kconfig
# Copyright (c) 2023 Trackunit Corporation
# SPDX-License-Identifier: Apache-2.0


config SENSOR_BMI323_HPI
	bool "BMI323 measurement unit"
	default y
	select I2C
	help
		Enable driver for BMI323 IMU sensor.

module = BMI323_HPI
module-str = bmi323_hpi

source "subsys/logging/Kconfig.template.log_config"
```

## healthypi-move-fw/drivers/sensor/max32664c/Kconfig
```kconfig
# Configuration options

config SENSOR_MAX32664C
	bool "MAX32664C Driver"
	default y
	select I2C
	help
		Enable the driver for the Maxim MAX32664C sensor

module = MAX32664C
module-str = max32664c

source "subsys/logging/Kconfig.template.log_config"
```

## healthypi-move-fw/drivers/sensor/max32664d/Kconfig
```kconfig
# Configuration options

config SENSOR_MAX32664D
	bool "MAX32664D Driver"
	default y
	select I2C
	help
		Enable the driver for the Maxim MAX32664D sensor

module = MAX32664D
module-str = max32664d

source "subsys/logging/Kconfig.template.log_config"
```

## healthypi-move-fw/dts/bindings/display/sitronix,sh8601.yaml
```yaml
#
# Copyright 2024 Protocentral Electronics
# 
# SPDX-License-Identifier: Apache-2.0
# 
# SH8601 AMOLED display driver.
#

description: SH8601 480x480 circular display controller

compatible: "sitronix,sh8601"

include: [spi-device.yaml, display-controller.yaml]

properties:
    reset-gpios:
      type: phandle-array
      required: true
      description: RESET pin

        The RESET pin of the SH8601 is active low.
        If connected directly the MCU pin should be configured
        as active low.
    
    pixel-format:
      type: int
      default: 1
      enum:
        - 0 # RGB565
        - 1 # RGB888
      description:
        Display pixel format. 
    rotation:
      type: int
      default: 0
      enum:
        - 0
        - 90
        - 180
        - 270
      description:
        Display rotation (CW) in degrees.
    
    display-inversion:
      type: boolean
      description:
        Display inversion mode. Every bit is inverted from the frame memory to
        the display.
```

## lib/Kconfig
```kconfig
# SPDX-License-Identifier: Apache-2.0

menu "HealthyPi Modules"
rsource "max32664_updater/Kconfig"
endmenu
```

## lib/max32664_updater/Kconfig
```kconfig
# Configuration options

config MAX32664_UPDATER
	bool "MAX32664 Updater"
	default y
	select I2C
	help
		Enable the driver for the Maxim MAX32664 Updater

config MAX32664_UPDATER_INCLUDE_FALLBACK_ARRAYS
	bool "Include fallback firmware arrays"
	depends on MAX32664_UPDATER
	default n
	help
		Include the original firmware arrays as fallback in case
		the filesystem-based firmware files are not available.
		This increases flash usage but provides a backup mechanism.
		Disable this to save maximum flash space.

module = MAX32664_UPDATER
module-str = max32664_updater

source "subsys/logging/Kconfig.template.log_config"
```
